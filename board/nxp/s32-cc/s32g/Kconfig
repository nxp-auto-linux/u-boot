## board/nxp/s32-cc/s32g/Kconfig
```kconfig
config NXP_S32GRDB_BOARD
	bool
	default n
	imply BOARD_LATE_INIT
	imply CMD_PMIC
	imply DM_PMIC
	imply DM_PMIC_FS5600
	imply DM_PMIC_PF5020
	imply DM_PMIC_VR5510
	imply NXP_S32CC_BOARD_COMMON
	imply PHY_MICREL
	imply PHY_MICREL_KSZ90X1
	select ADC
	select DM_REGULATOR
	select OF_BOARD_SETUP
	select SARADC_S32CC
	select SPI_FLASH_MACRONIX
	select SPI_FLASH_MX25UW51245G
	select SPI_FLASH_SOFT_RESET
	select SPI_FLASH_SOFT_RESET_ON_BOOT

config NXP_S32GEVB3_BOARD
	bool
	default n
	select NXP_S32GEVB_BOARD

config NXP_S32GEVB_BOARD
	bool
	default n
	imply ADC
	imply CMD_EEPROM
	imply CMD_PMIC
	imply DM_PMIC
	imply DM_PMIC_VR5510
	imply I2C_EEPROM
	imply NXP_S32CC_BOARD_COMMON
	imply PHY
	imply PHY_MICREL
	imply PHY_MICREL_KSZ90X1
	imply SARADC_S32CC
	imply SJA1105X
	select MISC_INIT_R
	select SPI_FLASH_MACRONIX
	select SPI_FLASH_MX25UW51245G
	select SPI_FLASH_SOFT_RESET
	select SPI_FLASH_SOFT_RESET_ON_BOOT

config NXP_S32G274ABLUEBOX3_BOARD
	bool
	default n
	imply CMD_EEPROM
	imply CMD_GPIO
	imply CMD_PMIC
	imply DM_PMIC
	imply DM_PMIC_VR5510
	imply GPIO_HOG
	imply I2C_EEPROM
	imply NXP_S32CC_BOARD_COMMON
	imply PHY
	imply PHYLIB
	imply PHY_GIGE
	imply PHY_ATHEROS
	imply SARADC_S32CC
	select SPI_FLASH_MT35XU
	select SPI_FLASH_STMICRO
	select SPI_FLASH_SOFT_RESET
	select SPI_FLASH_SOFT_RESET_ON_BOOT

config NXP_S32G3VCBASE_BOARD
	bool
	default n
	select NXP_S32G3VC_BOARD

config NXP_S32G3VCSOM_BOARD
	bool
	default n
	select NXP_S32G3VC_BOARD

config NXP_S32G3VC_BOARD
	bool
	default n
	imply BOARD_LATE_INIT
	imply NXP_S32CC_BOARD_COMMON
	select SYSINFO
	select SYSINFO_GPIO
```

## board/nxp/s32/Kconfig
```kconfig
# SPDX-License-Identifier: GPL-2.0+ OR BSD-3-Clause
# Copyright 2024 NXP

if MACH_S32

config SYS_VENDOR
	string
	default "nxp"

if USE_BOOTARGS
config BOOTARGS
	default "root=/dev/ram rw earlycon loglevel=7"
endif

endif
```

## board/nxp/s32g274abluebox3/Kconfig
```kconfig
# SPDX-License-Identifier: GPL-2.0+
# Copyright 2022-2023 NXP

if TARGET_S32G274ABLUEBOX3

config SYS_CONFIG_NAME
	default "s32g274abluebox3"

config SYS_BOARD
	default "s32g274abluebox3"

config NR_DRAM_BANKS
	default 2

config ENV_SECT_SIZE
	default 0x1000 if QSPI_BOOT

config SYS_EEPROM_PAGE_WRITE_DELAY_MS
	default 10

config SYS_EEPROM_SIZE
	default 128

config ID_EEPROM
	default y

config SYS_I2C_EEPROM_ADDR
	default 0x57 if ID_EEPROM

config SYS_I2C_EEPROM_ADDR_LEN
	default 2 if ID_EEPROM

config OF_BOARD_SETUP
	default y

config S32CC_HWCONFIG
	string "S32CC HWConfig definition"
	depends on PHY_S32CC_SERDES
	default "serdes0:mode=pcie,clock=ext;pcie0:mode=ep;serdes1:mode=xpcs0,clock=int,fmhz=100;xpcs1_0:speed=1G"
	help
	  The configuration for the SerDes modules, stored in
	  the variable 'hwconfig'.
	  It configures generic attributes for 'serdesX', such as 'mode' (see below),
	  the clock type (internal or external),
	  clock frequency 'fmhz' (100 or 125, SGMII only modes), 'pcieX' mode
	  ('rc' or 'ep') and the 'xpcsX_Y' interfaces for any of the two lanes.
	  In the atributes presented above and below, 'X' (0 or 1) is the index
	  of the SerDes module and 'Y' (0 or 1) is the index of the XPCS interface.
	  SerDes 'mode' attribute can be 'pcie' (PCIe only mode), 'pcie&xpcsY' (PCIe
	  and SGMII combo mode), 'xpcs0&xpcs1' (SGMII only mode).
	  For the combo modes 'pcie&xpcsY', lane0 is PCIe and lane1
	  is connected to a GMAC or PFE MAC depending on 'Y' and 'fmhz' (which
	  match a certain SerDes configuration from the SerDes manual).
	  PCIe always works at 100MHz, therefore 'fmhz' is only for SGMII only mode.
	  Config 'xpcsX_Y' is used to specifically configure each of the two SGMII
	  PHYs, by setting the 'speed' (10M, 100M, 1G and 2G5).
	  S32G2 has 1 GMAC running at 1Gbps and 3 PFE MACs, running at 10Mbps - 2.5Gbps speeds.

endif
```

## board/nxp/s32g274aemu/Kconfig
```kconfig
# SPDX-License-Identifier: GPL-2.0+
# Copyright 2022 NXP

if TARGET_S32G274AEMU

config SYS_CONFIG_NAME
	default "s32g274aemu"

config SYS_BOARD
	default "s32g274aemu"

config NR_DRAM_BANKS
	default 2

config BOOTARGS
	default "root=/dev/ram rw earlycon loglevel=7"

endif
```

## board/nxp/s32g274ardb2/Kconfig
```kconfig
# SPDX-License-Identifier: GPL-2.0+
# Copyright 2022 NXP

if TARGET_S32G274ARDB2

config SYS_CONFIG_NAME
	default "s32g274ardb2"

config SYS_BOARD
	default "s32g274ardb2"

config NR_DRAM_BANKS
	default 2

config ENV_SECT_SIZE
	default 0x10000 if QSPI_BOOT

endif
```

## board/nxp/s32g2xxaevb/Kconfig
```kconfig
# SPDX-License-Identifier: GPL-2.0+
# Copyright 2022 NXP

if TARGET_S32G2XXAEVB

config SYS_CONFIG_NAME
	default "s32g2xxaevb"

config SYS_BOARD
	default "s32g2xxaevb"

config NR_DRAM_BANKS
	default 2

config ENV_SECT_SIZE
	default 0x10000 if QSPI_BOOT

config SYS_EEPROM_PAGE_WRITE_DELAY_MS
	default 10

config SYS_EEPROM_SIZE
	default 128

config S32CC_HWCONFIG
	string "S32CC HWConfig definition"
	depends on PHY_S32CC_SERDES
	default "serdes0:mode=pcie,clock=ext;pcie0:mode=rc;serdes1:mode=xpcs0&xpcs1,clock=ext,fmhz=125;xpcs1_0:speed=2G5;xpcs1_1:speed=2G5"
	help
	  The configuration for the SerDes modules, stored in
	  the variable 'hwconfig'.
	  It configures generic attributes for 'serdesX', such as 'mode' (see below),
	  the clock type (internal or external),
	  clock frequency 'fmhz' (100 or 125, SGMII only modes), 'pcieX' mode
	  ('rc' or 'ep') and the 'xpcsX_Y' interfaces for any of the two lanes.
	  In the atributes presented above and below, 'X' (0 or 1) is the index
	  of the SerDes module and 'Y' (0 or 1) is the index of the XPCS interface.
	  SerDes 'mode' attribute can be 'pcie' (PCIe only mode), 'pcie&xpcsY' (PCIe
	  and SGMII combo mode), 'xpcs0&xpcs1' (SGMII only mode).
	  For the combo modes 'pcie&xpcsY', lane0 is PCIe and lane1
	  is connected to a GMAC or PFE MAC depending on 'Y' and 'fmhz' (which
	  match a certain SerDes configuration from the SerDes manual).
	  PCIe always works at 100MHz, therefore 'fmhz' is only for SGMII only mode.
	  Config 'xpcsX_Y' is used to specifically configure each of the two SGMII
	  PHYs, by setting the 'speed' (10M, 100M, 1G and 2G5).
	  S32G2 has 1 GMAC running at 1Gbps and 3 PFE MACs, running at 10Mbps - 2.5Gbps speeds.

endif
```

## board/nxp/s32g399aemu/Kconfig
```kconfig
# SPDX-License-Identifier: GPL-2.0+
# Copyright 2023 NXP

if TARGET_S32G399AEMU

config SYS_CONFIG_NAME
	default "s32g399aemu"

config SYS_BOARD
	default "s32g399aemu"

config NR_DRAM_BANKS
	default 2

config BOOTARGS
	default "root=/dev/ram rw earlycon loglevel=7"

config S32CC_HWCONFIG
	string "S32CC HWConfig definition"
	depends on PHY_S32CC_SERDES
	default ""
	help
	  The configuration for the SerDes modules, stored in
	  the variable 'hwconfig'.
	  It configures generic attributes for 'serdesX', such as 'mode' (see below),
	  the clock type (internal or external),
	  clock frequency 'fmhz' (100 or 125, SGMII only modes), 'pcieX' mode
	  ('rc' or 'ep') and the 'xpcsX_Y' interfaces for any of the two lanes.
	  In the atributes presented above and below, 'X' (0 or 1) is the index
	  of the SerDes module and 'Y' (0 or 1) is the index of the XPCS interface.
	  SerDes 'mode' attribute can be 'pcie' (PCIe only mode), 'pcie&xpcsY' (PCIe
	  and SGMII combo mode), 'xpcs0&xpcs1' (SGMII only mode).
	  For the combo modes 'pcie&xpcsY', lane0 is PCIe and lane1
	  is connected to a GMAC or PFE MAC depending on 'Y' and 'fmhz' (which
	  match a certain SerDes configuration from the SerDes manual).
	  PCIe always works at 100MHz, therefore 'fmhz' is only for SGMII only mode.
	  Config 'xpcsX_Y' is used to specifically configure each of the two SGMII
	  PHYs, by setting the 'speed' (10M, 100M, 1G and 2G5).
	  S32G3 has 1 GMAC running at 1Gbps and 3 PFE MACs, running at 10Mbps - 2.5Gbps speeds.

endif
```

## board/nxp/s32g399ardb3/Kconfig
```kconfig
# SPDX-License-Identifier: GPL-2.0+
# Copyright 2022 NXP

if TARGET_S32G399ARDB3

config SYS_CONFIG_NAME
	default "s32g399ardb3"

config SYS_BOARD
	default "s32g399ardb3"

config NR_DRAM_BANKS
	default 2

config ENV_SECT_SIZE
	default 0x10000 if QSPI_BOOT

config SYS_EEPROM_PAGE_WRITE_DELAY_MS
	default 10

config SYS_EEPROM_SIZE
	default 128

endif
```

## board/nxp/s32g399asom/Kconfig
```kconfig
# SPDX-License-Identifier: GPL-2.0+ OR BSD-3-Clause
# Copyright 2024 NXP

if TARGET_S32G399ASOM

config SYS_CONFIG_NAME
	default "s32g399asom"

config SYS_BOARD
	default "s32g399asom"

config NR_DRAM_BANKS
	default 2

config ENV_SECT_SIZE
	default 0x10000 if QSPI_BOOT

config SYS_EEPROM_PAGE_WRITE_DELAY_MS
	default 10

config SYS_EEPROM_SIZE
	default 128

config S32CC_HWCONFIG
	string "S32CC HWConfig definition"
	depends on PHY_S32CC_SERDES
	default "serdes0:mode=pcie,clock=ext;pcie0:mode=rc;serdes1:mode=xpcs0&xpcs1,clock=ext,fmhz=125;xpcs1_0:speed=1G,an=0;xpcs1_1:speed=1G"
	help
	  The configuration for the SerDes modules, stored in
	  the variable 'hwconfig'.
	  It configures generic attributes for 'serdesX', such as 'mode' (see below),
	  the clock type (internal or external),
	  clock frequency 'fmhz' (100 or 125, SGMII only modes), 'pcieX' mode
	  ('rc' or 'ep') and the 'xpcsX_Y' interfaces for any of the two lanes.
	  In the atributes presented above and below, 'X' (0 or 1) is the index
	  of the SerDes module and 'Y' (0 or 1) is the index of the XPCS interface.
	  PCIe always works at 100MHz, therefore 'fmhz' is only for SGMII only mode.
	  Config 'xpcsX_Y' is used to specifically configure each of the two SGMII
	  PHYs, by setting the 'speed' (10M, 100M, 1G and 2G5).
	  In case of S32G3-VC-SOM board, SerDes0 can operate in PCIE mode only,
	  while SerDes1 can only be used in SGMII mode.
	  Thus, default configuration 'mode' parameter should not be modified.

endif
```

## board/nxp/s32g3xxaevb/Kconfig
```kconfig
# SPDX-License-Identifier: GPL-2.0+
# Copyright 2022 NXP

if TARGET_S32G3XXAEVB

config SYS_CONFIG_NAME
	default "s32g3xxaevb"

config SYS_BOARD
	default "s32g3xxaevb"

config NR_DRAM_BANKS
	default 2

endif
```

## board/nxp/s32r45emu/Kconfig
```kconfig
# SPDX-License-Identifier: GPL-2.0+
# Copyright 2022 NXP

if TARGET_S32R45EMU

config SYS_CONFIG_NAME
	default "s32r45emu"

config SYS_BOARD
	default "s32r45emu"

config NR_DRAM_BANKS
	default 2

config BOOTARGS
	default "root=/dev/ram rw earlycon loglevel=7"

endif
```

## board/nxp/s32r45evb/Kconfig
```kconfig
# SPDX-License-Identifier: GPL-2.0+
# Copyright 2022 NXP

if TARGET_S32R45EVB

config SYS_CONFIG_NAME
	default "s32r45evb"

config SYS_BOARD
	default "s32r45evb"

config NR_DRAM_BANKS
	default 2

endif
```

## configs/s32g274a_emu_defconfig
```kconfig
CONFIG_ARM=y
CONFIG_ARCH_S32G2=y
CONFIG_TARGET_S32G274AEMU=y
# CONFIG_SYS_MALLOC_CLEAR_ON_INIT is not set
CONFIG_FIT=y
CONFIG_SD_BOOT=y
# CONFIG_DM_SEQ_ALIAS is not set
# CONFIG_DM_I2C is not set
# CONFIG_SYS_I2C_MXC is not set
# CONFIG_DM_ETH is not set
# CONFIG_PCI is not set
# CONFIG_SPI is not set
# CONFIG_SPI_FLASH is not set
```

## configs/s32g274a_sim_defconfig
```kconfig
CONFIG_ARM=y
CONFIG_ARCH_S32=y
CONFIG_SYS_TEXT_BASE=0x380a0000
CONFIG_ENV_SIZE=0x2000
CONFIG_NR_DRAM_BANKS=3
CONFIG_TARGET_S32G274ASIM=y
CONFIG_DISTRO_DEFAULTS=y
# CONFIG_SYS_MALLOC_F is not set
CONFIG_FIT=y
CONFIG_USE_BOOTARGS=y
CONFIG_BOOTARGS="root=/dev/ram rw earlycon"
CONFIG_ARCH_EARLY_INIT_R=y
CONFIG_BOARD_EARLY_INIT_F=y
CONFIG_CMD_MEMTEST=y
CONFIG_DM=y
# CONFIG_DM_DEVICE_REMOVE is not set
# CONFIG_DM_SEQ_ALIAS is not set
# CONFIG_MMC is not set
CONFIG_DM_ETH=y
CONFIG_DWC_ETH_QOS_DEVICES=y
CONFIG_FSL_LINFLEXUART=y
```

## configs/s32g274abluebox3_qspi_defconfig
```kconfig
CONFIG_ARM=y
CONFIG_ARCH_S32G2=y
# CONFIG_SPI_FLASH_BAR is not set
CONFIG_TARGET_S32G274ABLUEBOX3=y
CONFIG_QSPI_BOOT=y
# CONFIG_DWC_ETH_QOS_DEVICES is not set
```

## configs/s32g274aevb_qspi_defconfig
```kconfig
CONFIG_FLASH_BOOT=y
CONFIG_ARM=y
CONFIG_ARM_SMCCC=y
CONFIG_ARCH_S32=y
CONFIG_SYS_TEXT_BASE=0x34020000
CONFIG_TARGET_S32G274AEVB=y
CONFIG_S32_LPDDR4=y
CONFIG_SYS_DDR_SIZE=0x20000000
CONFIG_ARMV8_MULTIENTRY=y
CONFIG_DEFAULT_DEVICE_TREE="fsl-s32g274aevb"
CONFIG_DISTRO_DEFAULTS=y
CONFIG_NR_DRAM_BANKS=1
# CONFIG_SYS_MALLOC_F is not set
CONFIG_TOOLS_DEBUG=y
CONFIG_FIT=y
CONFIG_SYS_EXTRA_OPTIONS="IMX_CONFIG=board/freescale/s32-gen1/s32-gen1.cfg"
CONFIG_USE_BOOTARGS=y
CONFIG_ARCH_EARLY_INIT_R=y
CONFIG_BOARD_EARLY_INIT_F=y
CONFIG_CMD_EEPROM=y
CONFIG_CMD_MD5SUM=y
CONFIG_MD5SUM_VERIFY=y
CONFIG_CMD_MEMTEST=y
CONFIG_CMD_I2C=y
CONFIG_CMD_MMC=y
CONFIG_CMD_PCI=y
CONFIG_CMD_SF=y
CONFIG_CMD_SPI=y
CONFIG_CMD_SMC=y
CONFIG_OF_EMBED=y
CONFIG_NET_RANDOM_ETHADDR=y
CONFIG_DM=y
# CONFIG_DM_DEVICE_REMOVE is not set
CONFIG_SYS_I2C_MXC=y
CONFIG_FSL_ESDHC=y
CONFIG_DM_SPI_FLASH=y
CONFIG_SPI_FLASH=y
# CONFIG_SPI_FLASH_BAR is not set
CONFIG_SPI_FLASH_MACRONIX=y
CONFIG_PHYLIB_10G=y
CONFIG_PHY_AQUANTIA=y
CONFIG_PHY_MICREL=y
CONFIG_PHY_MICREL_KSZ90X1=y
CONFIG_PHY_FIXED=y
CONFIG_DM_ETH=y
CONFIG_FSL_PFENG=y
CONFIG_FSL_PFENG_FW_LOC_QSPI=y
CONFIG_FSL_PFENG_EMAC_1_RGMII=y
CONFIG_DWC_ETH_QOS_DEVICES=y
CONFIG_DWC_ETH_QOS_S32CC=y
CONFIG_RGMII=y
CONFIG_PCI=y
CONFIG_DM_PCI=y
CONFIG_PCIE_S32GEN1=y
CONFIG_FSL_LINFLEXUART=y
CONFIG_SPI=y
CONFIG_DM_SPI=y
CONFIG_FSL_DSPI=y
CONFIG_FSL_QSPI=y
CONFIG_SJA1105=y
# CONFIG_EFI_LOADER is not set
```

## configs/s32g274ardb2_defconfig
```kconfig
CONFIG_ARM=y
CONFIG_ARCH_S32G2=y
CONFIG_ENV_SIZE=0x2000
CONFIG_ENV_OFFSET=0x1e0000
# CONFIG_DISPLAY_CPUINFO is not set
CONFIG_CMD_MD5SUM=y
CONFIG_MD5SUM_VERIFY=y
CONFIG_CMD_GPIO=y
CONFIG_CMD_MMC=y
CONFIG_CMD_FAT=y
CONFIG_ENV_IS_IN_MMC=y
CONFIG_DM_SERIAL=y
```

## configs/s32g274ardb_qspi_defconfig
```kconfig
CONFIG_FLASH_BOOT=y
CONFIG_ARM=y
CONFIG_ARM_SMCCC=y
CONFIG_ARCH_S32=y
CONFIG_SYS_TEXT_BASE=0x34020000
CONFIG_TARGET_S32G274ARDB=y
CONFIG_S32_LPDDR4=y
CONFIG_SYS_DDR_SIZE=0x20000000
CONFIG_EXTRA_KERNEL_BOOT_ARGS="usb-storage.quirks=*:*:r"
CONFIG_ARMV8_MULTIENTRY=y
CONFIG_DEFAULT_DEVICE_TREE="fsl-s32g274ardb"
CONFIG_DISTRO_DEFAULTS=y
# CONFIG_SYS_MALLOC_F is not set
CONFIG_TOOLS_DEBUG=y
CONFIG_FIT=y
CONFIG_SYS_EXTRA_OPTIONS="IMX_CONFIG=board/freescale/s32-gen1/s32-gen1.cfg"
CONFIG_USE_BOOTARGS=y
CONFIG_ARCH_EARLY_INIT_R=y
CONFIG_BOARD_EARLY_INIT_F=y
CONFIG_CMD_MD5SUM=y
CONFIG_MD5SUM_VERIFY=y
CONFIG_CMD_MEMTEST=y
CONFIG_CMD_I2C=y
CONFIG_CMD_MMC=y
CONFIG_CMD_SF=y
CONFIG_CMD_SPI=y
CONFIG_CMD_SMC=y
CONFIG_OF_EMBED=y
CONFIG_NET_RANDOM_ETHADDR=y
CONFIG_DM=y
# CONFIG_DM_DEVICE_REMOVE is not set
CONFIG_SYS_I2C_MXC=y
CONFIG_FSL_ESDHC=y
CONFIG_DM_SPI_FLASH=y
CONFIG_SPI_FLASH=y
CONFIG_SPI_FLASH_BAR=y
CONFIG_SPI_FLASH_MACRONIX=y
CONFIG_PHY_ATHEROS=y
CONFIG_PHY_MICREL=y
CONFIG_PHY_MICREL_KSZ90X1=y
CONFIG_PHY_FIXED=y
CONFIG_DM_ETH=y
CONFIG_FSL_PFENG=y
CONFIG_FSL_PFENG_FW_LOC_QSPI=y
CONFIG_FSL_PFENG_EMAC_1_RGMII=y
CONFIG_DWC_ETH_QOS_DEVICES=y
CONFIG_DWC_ETH_QOS_S32CC=y
CONFIG_RGMII=y
CONFIG_FSL_LINFLEXUART=y
CONFIG_SPI=y
CONFIG_DM_SPI=y
CONFIG_FSL_DSPI=y
CONFIG_FSL_QSPI=y
CONFIG_SJA1105=n
CONFIG_ENV_SIZE=0x2000
CONFIG_ENV_OFFSET=0x80000
```

## configs/s32g2xxaevb_defconfig
```kconfig
CONFIG_ARM=y
CONFIG_ARCH_S32G2=y
# CONFIG_SPI_FLASH_BAR is not set
CONFIG_TARGET_S32G2XXAEVB=y
CONFIG_SD_BOOT=y
CONFIG_USB_ULPI_VIEWPORT=y
```

## configs/s32g399a_emu_defconfig
```kconfig
CONFIG_ARM=y
CONFIG_ARCH_S32=y
CONFIG_ENV_SIZE=0x2000
CONFIG_ENV_OFFSET=0x1e0000
CONFIG_NR_DRAM_BANKS=3
CONFIG_TARGET_S32G399AEMU=y
CONFIG_S32_ATF_BOOT_FLOW=y
CONFIG_DISTRO_DEFAULTS=y
# CONFIG_SYS_MALLOC_CLEAR_ON_INIT is not set
CONFIG_TOOLS_DEBUG=y
CONFIG_FIT=y
CONFIG_SD_BOOT=y
CONFIG_USE_BOOTARGS=y
CONFIG_BOOTARGS="root=/dev/ram rw earlycon"
CONFIG_ARCH_EARLY_INIT_R=y
CONFIG_CMD_MEMTEST=y
CONFIG_CMD_MMC=y
CONFIG_CMD_SMC=y
CONFIG_DEFAULT_DEVICE_TREE="fsl-s32g399aemu"
CONFIG_ENV_IS_IN_MMC=y
CONFIG_DM=y
# CONFIG_DM_DEVICE_REMOVE is not set
# CONFIG_DM_SEQ_ALIAS is not set
CONFIG_DM_MMC=y
CONFIG_FSL_USDHC=y
```

## configs/s32g399ardb3_qspi_defconfig
```kconfig
CONFIG_ARM=y
CONFIG_ARCH_S32G3=y
# CONFIG_SPI_FLASH_BAR is not set
CONFIG_QSPI_BOOT=y
CONFIG_FSL_PFENG_FW_LOC_SDCARD=y
```
