## board/nxp/s32n/Kconfig
```kconfig
# SPDX-License-Identifier: GPL-2.0+ OR BSD-3-Clause
# Copyright 2024-2026 NXP

if NXP_S32N

config NXP_S32N_BOARD_COMMON
	bool
	default n
	imply CMD_CACHE
	imply CMD_CPU
	imply CMD_DM
	imply CMD_MD5SUM
	imply MD5SUM_VERIFY
	imply USE_BOOTARGS

config SYS_LOAD_RAM_OFFSET
	hex "Default OS image offset in RAM."
	default 0x13200000
	help
	  Offset from the start of DRAM where the OS image is loaded. It
	  sets the default value of the "loadaddr" environment variable.

config DTB_RAM_OFFSET
	hex "Default OS device tree blob offset in RAM."
	default 0x13100000
	help
	  Offset from the start of DRAM where the OS device tree blob is
	  loaded. It sets the default value of the "fdt_addr" environment
	  variable. The space between this offset and SYS_LOAD_RAM_OFFSET
	  holds the device tree.

config RAMDISK_RAM_OFFSET
	hex "Default ramdisk offset in RAM to be used by the OS."
	default 0x16000000

config KERNEL_COMP_RAM_OFFSET
	hex "Offset in RAM of the area used to decompress the OS image."
	default 0x17200000
	help
	  A compressed OS image is decompressed into the area at this offset
	  and then moved to the load address. The area must not overlap the
	  compressed image and must have room for the decompressed one.

endif
```
