// SPDX-License-Identifier: GPL-2.0-or-later
/*
 * Copyright 2021-2022 NXP
 */

/dts-v1/;
#include "s32g2.dtsi"
#include "s32gxxxaevb.dtsi"

/ {
	model = "NXP S32G2XXX-EVB";
};

&usdhc0 {
	no-1-8-v;
};

&usbotg {
	status = "okay";
};
