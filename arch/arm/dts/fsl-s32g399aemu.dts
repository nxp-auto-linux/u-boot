// SPDX-License-Identifier: GPL-2.0-or-later
/*
 * Copyright 2021-2022 NXP
 */

/dts-v1/;
#include "fsl-s32g.dtsi"
#include "fsl-s32g3.dtsi"

/delete-node/ &mem1;
/delete-node/ &mem2;
/ {
	model = "ZeBu model for NXP S32G399A";

	mem1: memory@80000000 {
		device_type = "memory";
		reg = <0 0x80000000 0 0x40000000>;
	};
};

&usdhc0 {
	status = "okay";
};
