// SPDX-License-Identifier: GPL-2.0-or-later
/*
 * Copyright 2021 NXP
 */

/dts-v1/;
#include "fsl-s32g.dtsi"
#include "fsl-s32g398a.dtsi"

/delete-node/ &mem1;
/delete-node/ &mem2;
/ {

	mem1: memory@80000000 {
		device_type = "memory";
		reg = <0 0x80000000 0 0x40000000>;
	};
};

&usdhc0 {
	status = "okay";
};
