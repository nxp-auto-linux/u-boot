// SPDX-License-Identifier: GPL-2.0-or-later
/*
 * Copyright 2021-2022 NXP
 */

/dts-v1/;
#include "fsl-s32g.dtsi"
#include "fsl-s32g3.dtsi"
#include "fsl-s32gxxxaevb.dtsi"

/ {
	model = "NXP S32G3XXX-EVB";
};

&pcie0 {
	no-check-serdes;
};

&pcie1 {
	no-check-serdes;
};
