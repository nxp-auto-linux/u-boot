// SPDX-License-Identifier: GPL-2.0-or-later
/*
 * Copyright 2019-2020, 2022 NXP
 */

/dts-v1/;
#include "s32g2.dtsi"
#include "s32gxxxardb.dtsi"

/ {
	model = "NXP S32G274A-RDB2";
};

&usdhc0 {
	no-1-8-v;
};
