// SPDX-License-Identifier:     GPL-2.0+
/*
 * Copyright 2019,2022 NXP
 */
/dts-v1/;
/ {
	compatible = "fsl,s32gen1";
	signature {
		key-boot_key {
			required = "conf";
			algo = "sha1,rsa2048";
			key-name-hint = "boot_key";
		};
	};
};

