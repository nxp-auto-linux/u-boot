// SPDX-License-Identifier: GPL-2.0-or-later
/*
 * Copyright 2021-2022 NXP
 */

/dts-v1/;
#include "s32g274a.dtsi"
#include "s32gxxxaevb.dtsi"

/ {
	model = "NXP S32G2XXX-EVB";
	compatible = "nxp,s32cc", "arm,vexpress,v2p-aarch64", "arm,vexpress";
};

&usdhc0 {
	no-1-8-v;
};
