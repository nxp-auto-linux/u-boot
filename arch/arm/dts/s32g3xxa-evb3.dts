// SPDX-License-Identifier: GPL-2.0-or-later
/*
 * Copyright 2022 NXP
 */

/dts-v1/;
#include "s32g.dtsi"
#include "s32g3.dtsi"
#include "s32gxxxaevb.dtsi"

/ {
	model = "NXP S32G3XXX-EVB3";
};

&usdhc0 {
	no-1-8-v;
};
