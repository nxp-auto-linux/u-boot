// SPDX-License-Identifier: GPL-2.0-or-later
/*
 * Copyright 2019-2020 NXP
 */

/dts-v1/;
#include "fsl-s32g274ardb.dtsi"

&gmac0 {
	status = "okay";
	phy-mode = "rgmii";
	/* SJA1105 */
	fixed-link {
		speed = <1000>;
		full-duplex;
	};
};
