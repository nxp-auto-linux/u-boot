## arch/arm/mach-s32/s32n/Kconfig
```kconfig
# SPDX-License-Identifier: GPL-2.0+ OR BSD-3-Clause
# Copyright 2024,2026 NXP

if NXP_S32N

config LMB_MAX_REGIONS
	default 16

config S32N_CMD_DDR_INIT
	bool "ddr_init - initialize a DDR region via the NXP DDR SCMI protocol"
	depends on NXP_DDR_SCMI
	help
	  Adds the 'ddr_init' command, which brings up a high DDR region
	  on NXP S32N SoCs by asking the FSS firmware to initialize it. This
	  is useful for initializing DDR that is not initialized by FSS itself
	  or via requests from other components earlier in the boot flow.

source "arch/arm/mach-s32/s32n79/Kconfig"
source "board/nxp/s32n/Kconfig"

endif
```

## arch/arm/mach-s32/s32n79/Kconfig
```kconfig
# SPDX-License-Identifier: GPL-2.0+ OR BSD-3-Clause
# Copyright 2024-2025 NXP

if ARCH_S32N79

choice
	prompt "S32N79 board select"
	default TARGET_S32N79RDB

config TARGET_S32N79SIM
	bool "Support S32N79SIM simulator"
	help
	  This board is based on the S32N79 simulator.
	select SPI_FLASH_SPANSION
	select SPI_FLASH_S28HX_T

config TARGET_S32N79RDB
	bool "Support S32N79 Reference Design Board"
	help
	  This board is based on S32N79 SoC.

endchoice

config ENV_IS_IN_FAT
	default y

config ENV_FAT_INTERFACE
	default "mmc" if SD_BOOT
	default "scsi"

config ENV_FAT_DEVICE_AND_PART
	default "0:3"

config ENV_SIZE
	default 0x2000

if DEBUG_UART

# Use UART0 by default
config DEBUG_UART_BASE
	default 0x4A030000

endif

source "board/nxp/s32n79sim/Kconfig"
source "board/nxp/s32n79rdb/Kconfig"

endif
```

## arch/arm/mach-s32/s32r47/Kconfig
```kconfig
# SPDX-License-Identifier: GPL-2.0+
# Copyright 2025 NXP

if ARCH_S32R47

config TARGET_S32R478AEVB
	bool "Support S32R478AEVB board"
	default y
	help
	  This board is based on S32R47 SoC. Is is equipped with
	  4GB of RAM, 64MB of QSPI memory, PCIe slot, serial port,
	  I2C and DSPI.
	imply ADC
	imply CMD_EEPROM
	imply I2C_EEPROM
	imply NXP_S32CC_BOARD_COMMON
	imply PHY_NXP_C45_TJA11XX
	imply PHY_FIXED
	imply SARADC_S32CC
	select SPI_FLASH_STMICRO
	select SPI_FLASH_SOFT_RESET
	select SPI_FLASH_SOFT_RESET_ON_BOOT

source "board/nxp/s32r478aevb/Kconfig"

endif
```

## board/nxp/s32n/Kconfig
```kconfig
# SPDX-License-Identifier: GPL-2.0+ OR BSD-3-Clause
# Copyright 2024-2025 NXP

if NXP_S32N

config NXP_S32N_BOARD_COMMON
	bool
	default n
	imply CMD_CACHE
	imply CMD_CPU
	imply CMD_DM
	imply CMD_MD5SUM
	imply MD5SUM_VERIFY
	imply USE_BOOTARGS

config SYS_LOAD_RAM_OFFSET
	hex "Default OS image offset in RAM."
	default 0x13200000

config DTB_RAM_OFFSET
	hex "Default OS device tree blob offset in RAM."
	default 0x13100000

config RAMDISK_RAM_OFFSET
	hex "Default ramdisk offset in RAM to be used by the OS."
	default 0x16000000

endif
```

## board/nxp/s32n79rdb/Kconfig
```kconfig
# SPDX-License-Identifier: GPL-2.0+ OR BSD-3-Clause
# Copyright 2025 NXP

if TARGET_S32N79RDB

config SYS_CONFIG_NAME
	default "s32n79rdb"

config SYS_BOARD
	default "s32n79rdb"

config NR_DRAM_BANKS
	default 3

config ENV_FAT_FILE
	default "/FIRMWARE/NXP/s32n79rdb/u-boot/env.txt"

config DTB_FILE
	default "/FIRMWARE/NXP/s32n79rdb/linux/s32n79-rdb.dtb"

if DEBUG_UART

config DEBUG_UART_CLOCK
	default 132000000
endif

endif
```

## board/nxp/s32n79sim/Kconfig
```kconfig
# SPDX-License-Identifier: GPL-2.0+ OR BSD-3-Clause
# Copyright 2024 NXP

if TARGET_S32N79SIM

config SYS_CONFIG_NAME
	default "s32n79sim"

config SYS_BOARD
	default "s32n79sim"

config NR_DRAM_BANKS
	default 1

config ENV_FAT_FILE
	default "/FIRMWARE/NXP/s32n79sim/u-boot/env.txt"

if DEBUG_UART

config DEBUG_UART_CLOCK
	default 100000000
endif

endif
```

## board/nxp/s32r478aevb/Kconfig
```kconfig
# SPDX-License-Identifier: GPL-2.0+
# Copyright 2025 NXP

if TARGET_S32R478AEVB

config SYS_CONFIG_NAME
	default "s32r478aevb"

config SYS_BOARD
	default "s32r478aevb"

config NR_DRAM_BANKS
	default 1

config ENV_SECT_SIZE
	default 0x10000 if QSPI_BOOT

config SYS_EEPROM_PAGE_WRITE_DELAY_MS
	default 10

config SYS_EEPROM_SIZE
	default 128

config S32CC_HWCONFIG
	string "S32CC HWConfig definition"
	depends on PHY_S32CC_SERDES
	default "serdes0:mode=pcie&xpcs1,clock=ext,fmhz=100;pcie0:mode=rc;xpcs0_1:speed=1G;serdes1:mode=xpcs0&xpcs1,clock=int,fmhz=125;xpcs1_0:speed=1G,an=0;xpcs1_1:speed=1G,an=0"
	help
	  The configuration for the SerDes modules, stored in
	  the variable 'hwconfig'.
	  It configures generic attributes for 'serdesX', such as 'mode' (see below),
	  the clock type (internal or external),
	  clock frequency 'fmhz' (100 or 125, SGMII only modes), 'pcieX' mode
	  ('rc' or 'ep') and the 'xpcsX_Y' interfaces for any of the two lanes.
	  In the atributes presented above and below, 'X' (0 or 1) is the index
	  of the SerDes module and 'Y' (0 or 1) is the index of the XPCS interface.
	  SerDes 'mode' attribute can be 'pcie' (PCIe only mode), 'pcie&xpcsY' (PCIe
	  and SGMII combo mode), 'xpcs0&xpcs1' (SGMII only mode).
	  For the combo modes 'pcie&xpcsY', lane0 is PCIe and lane1
	  is connected to a GMAC or PFE MAC depending on 'Y' and 'fmhz' (which
	  match a certain SerDes configuration from the SerDes manual).
	  PCIe always works at 100MHz, therefore 'fmhz' is only for SGMII only mode.
	  Config 'xpcsX_Y' is used to specifically configure each of the two SGMII
	  PHYs, by setting the 'speed' (10M, 100M, 1G and 2G5).
	  S32R45 has two GMACs, GMAC0 running at 1Gbps and GMAC1 running at 2.5Gbps.

endif
```

## configs/s32n79sim_ddr_defconfig
```kconfig
CONFIG_ARM=y
CONFIG_ARCH_S32N79=y
CONFIG_MEM_BOOT=y
CONFIG_BOOTDELAY=0
CONFIG_DEBUG_UART_PL011=y
```

## configs/s32r478aevb_qspi_defconfig
```kconfig
CONFIG_ARM=y
CONFIG_ARCH_S32R47=y
CONFIG_S32CC_QSPI_FREQ=100
CONFIG_QSPI_BOOT=y
# CONFIG_CMD_GPIO is not set
# CONFIG_CMD_MMC is not set
# CONFIG_CMD_SPI is not set
# CONFIG_SCMI_FIRMWARE is not set
# CONFIG_S32CC_GPIO is not set
# CONFIG_SCMI_GPIO is not set
# CONFIG_SCMI_NVMEM is not set
# CONFIG_MMC_IO_VOLTAGE is not set
# CONFIG_MMC_HS400_ES_SUPPORT is not set
# CONFIG_MMC_HS400_SUPPORT is not set
# CONFIG_FSL_USDHC is not set
# CONFIG_PINCTRL is not set
# CONFIG_PINCTRL_SCMI is not set
# CONFIG_RESET_SCMI is not set
# CONFIG_FSL_DSPI is not set
```

## drivers/pinctrl/nxp/Kconfig
```kconfig
config PINCTRL_IMX
	bool

config PINCTRL_IMX_MMIO
	bool
	select PINCTRL_IMX

config PINCTRL_IMX5
	bool "IMX5 pinctrl driver"
	depends on ARCH_MX5 && PINCTRL_FULL
	select DEVRES
	select PINCTRL_IMX_MMIO
	help
	  Say Y here to enable the imx5 pinctrl driver

	  This provides a simple pinctrl driver for i.MX 53SoC familiy,
	  i.MX53. This feature depends on device tree
	  configuration. This driver is different from the linux one,
	  this is a simple implementation, only parses the 'fsl,pins'
	  property and configure related registers.

config PINCTRL_IMX6
	bool "IMX6 pinctrl driver"
	depends on ARCH_MX6 && PINCTRL_FULL
	select DEVRES
	select PINCTRL_IMX_MMIO
	help
	  Say Y here to enable the imx6 pinctrl driver

	  This provides a simple pinctrl driver for i.MX6 SoC familiy,
	  i.MX6DQ/SL/SX/UL/DQP. This feature depends on device tree
	  configuration. This driver is different from the linux one,
	  this is a simple implementation, only parses the 'fsl,pins'
	  property and configure related registers.

config PINCTRL_IMX7
	bool "IMX7 pinctrl driver"
	depends on ARCH_MX7 && PINCTRL_FULL
	select DEVRES
	select PINCTRL_IMX_MMIO
	help
	  Say Y here to enable the imx7 pinctrl driver

	  This provides a simple pinctrl driver for i.MX7 SoC familiy,
	  i.MX7D. This feature depends on device tree
	  configuration. This driver is different from the linux one,
	  this is a simple implementation, only parses the 'fsl,pins'
	  property and configure related registers.

config PINCTRL_IMX7ULP
	bool "IMX7ULP pinctrl driver"
	depends on ARCH_MX7ULP && PINCTRL_FULL
	select DEVRES
	select PINCTRL_IMX_MMIO
	help
	  Say Y here to enable the imx7ulp pinctrl driver

	  This provides a simple pinctrl driver for i.MX7ULP SoC familiy.
	  This feature depends on device tree configuration. This driver
	  is different from the linux one, this is a simple implementation,
	  only parses the 'fsl,pins' property and configure related
	  registers.

config PINCTRL_IMX8ULP
	bool "IMX8ULP pinctrl driver"
	depends on ARCH_IMX8ULP && PINCTRL_FULL
	select DEVRES
	select PINCTRL_IMX_MMIO
	help
	  Say Y here to enable the imx8ulp pinctrl driver

	  This provides a simple pinctrl driver for i.MX8ULP SoC familiy.
	  This feature depends on device tree configuration. This driver
	  is different from the linux one, this is a simple implementation,
	  only parses the 'fsl,pins' property and configure related
	  registers.

config PINCTRL_IMX8
	bool "IMX8 pinctrl driver"
	depends on ARCH_IMX8 && PINCTRL_FULL
	select DEVRES
	select PINCTRL_IMX
	help
	  Say Y here to enable the imx8 pinctrl driver

	  This provides a simple pinctrl driver for i.MX8 SoC familiy.
	  This feature depends on device tree configuration. This driver
	  is different from the linux one, this is a simple implementation,
	  only parses the 'fsl,pins' property and configures related
	  registers.

config PINCTRL_IMX8M
	bool "IMX8M pinctrl driver"
	depends on ARCH_IMX8M && PINCTRL_FULL
	select PINCTRL_IMX_MMIO
	help
	  Say Y here to enable the imx8m pinctrl driver

	  This provides a simple pinctrl driver for i.MX8M SoC familiy.
	  This feature depends on device tree configuration. This driver
	  is different from the linux one, this is a simple implementation,
	  only parses the 'fsl,pins' property and configure related
	  registers.

config PINCTRL_IMX93
	bool "IMX8M pinctrl driver"
	depends on ARCH_IMX9 && PINCTRL_FULL
	select PINCTRL_IMX_MMIO
	help
	  Say Y here to enable the imx8m pinctrl driver

	  This provides a simple pinctrl driver for i.MX8M SoC familiy.
	  This feature depends on device tree configuration. This driver
	  is different from the linux one, this is a simple implementation,
	  only parses the 'fsl,pins' property and configure related
	  registers.

config PINCTRL_MXS
	bool "NXP MXS pinctrl driver"
	depends on ARCH_MX28 && PINCTRL_FULL
	help
	  Say Y here to enable the i.MX mxs pinctrl driver

	  This option provides a simple pinctrl driver for i.MX mxs SoC
	  familiy, e.g. i.MX28. This feature depends on device tree
	  configuration.

config PINCTRL_IMXRT
	bool "IMXRT pinctrl driver"
	depends on ARCH_IMXRT && PINCTRL_FULL
	select DEVRES
	select PINCTRL_IMX_MMIO
	help
	  Say Y here to enable the imxrt pinctrl driver

	  This provides a simple pinctrl driver for i.MXRT SoC familiy.
	  This feature depends on device tree configuration. This driver
	  is different from the linux one, this is a simple implementation,
	  only parses the 'fsl,pins' property and configure related
	  registers.

config PINCTRL_IMX_SCMI
	bool "IMX pinctrl SCMI driver"
	depends on ARCH_IMX9 && PINCTRL_FULL
	select PINCTRL_IMX
	help
	  This provides a simple pinctrl driver for i.MX SoC which supports
	  SCMI. This feature depends on device tree configuration. This driver
	  is different from the linux one, this is a simple implementation,
	  only parses the 'fsl,pins' property and configure related
	  registers.

	  Say Y here to enable the imx pinctrl SCMI driver

config PINCTRL_S32CC
	bool "S32CC pinctrl driver"
	depends on PINCTRL_FULL
	help
	  Say Y here to enable the pinctrl driver for S32 Common Chassis platforms.
	  This driver is the pinctrl driver for SIUL2 that is available on the
	  following SoCs: S32G2XX, S32G3XX, S32R45.

config PINCTRL_VYBRID
	bool "Vybrid (vf610) pinctrl driver"
	depends on ARCH_VF610 && PINCTRL_FULL
	select DEVRES
	select PINCTRL_IMX_MMIO
	help
	  Say Y here to enable the Vybrid (vf610) pinctrl driver

	  This provides a simple pinctrl driver for Vybrid SoC familiy,
	  vf610. This feature depends on device tree
	  configuration. This driver is different from the linux one,
	  this is a simple implementation, only parses the 'fsl,pins'
	  property and configure related registers.

config PINCTRL_NXP_S32CC_SCMI
	bool "NXP S32CC SCMI Pinctrl vendor extension driver"
	depends on NXP_S32CC
	select SCMI_FIRMWARE
	select SCMI_ID_VENDOR_80
	help
	  Say Y here to enable the NXP vendor extension pinctrl over
	  SCMI driver for S32 Common Chassis platforms (S32G2, S32G3,
	  S32R45, S32R47). This uses the NXP SCMI vendor protocol
	  (0x80) which is distinct from the standard SCMI pinctrl
	  protocol (0x19) used by PINCTRL_IMX_SCMI.
```
