## configs/s32g3xxaevb_defconfig
```kconfig
CONFIG_ARM=y
CONFIG_ARCH_S32G3=y
# CONFIG_DISPLAY_CPUINFO is not set
CONFIG_CMD_PMIC=y
CONFIG_DM_SERIAL=y
```

## configs/s32g3xxaevb_qspi_defconfig
```kconfig
CONFIG_ARM=y
CONFIG_ARCH_S32G3=y
CONFIG_TARGET_S32G3XXAEVB=y
CONFIG_QSPI_BOOT=y
CONFIG_USB_ULPI_VIEWPORT=y
CONFIG_S32CC_QSPI_FREQ=166
```

## configs/s32r45_emu_defconfig
```kconfig
CONFIG_ARM=y
CONFIG_ARCH_S32R45=y
CONFIG_ENV_SIZE=0x2000
CONFIG_TARGET_S32R45EMU=y
# CONFIG_SYS_MALLOC_CLEAR_ON_INIT is not set
CONFIG_FIT=y
CONFIG_SD_BOOT=y
CONFIG_USE_BOOTARGS=y
CONFIG_CMD_MEMTEST=y
CONFIG_CMD_MMC=y
CONFIG_CMD_SMC=y
# CONFIG_DM_SEQ_ALIAS is not set
# CONFIG_DM_I2C is not set
# CONFIG_SYS_I2C_MXC is not set
# CONFIG_DM_ETH is not set
# CONFIG_PCI is not set
# CONFIG_SPI is not set
```

## configs/s32r45evb_qspi_defconfig
```kconfig
CONFIG_ARM=y
CONFIG_ARCH_S32R45=y
CONFIG_QSPI_BOOT=y
CONFIG_CMD_CPU=y
CONFIG_CMD_MD5SUM=y
CONFIG_MD5SUM_VERIFY=y
CONFIG_CMD_FUSE=y
CONFIG_CMD_GPIO=y
CONFIG_CMD_MMC=y
CONFIG_CMD_SPI=y
CONFIG_CMD_TIME=y
CONFIG_CMD_TIMER=y
CONFIG_DM_SERIAL=y
```

## configs/s32r45renan_defconfig
```kconfig
CONFIG_ARM=y
CONFIG_ARCH_S32R45=y
CONFIG_TARGET_S32R45RENAN=y
CONFIG_S32CC_HWCONFIG="serdes0:mode=pcie,clock=ext;pcie0:mode=rc;serdes1:mode=pcie,clock=ext;pcie1:mode=rc"
CONFIG_SD_BOOT=y
CONFIG_CUSTOM_SYS_TEXT_BASE=y
CONFIG_SYS_TEXT_BASE=0xb7aa0000
CONFIG_CUSTOM_SYS_DATA_BASE=y
CONFIG_SYS_DATA_BASE=0xb7b40000
```

## configs/s32r45x_defconfig
```kconfig
CONFIG_ARM=y
CONFIG_ARCH_S32=y
CONFIG_SYS_TEXT_BASE=0x38020000
CONFIG_TARGET_S32R45X=y
CONFIG_S32_LPDDR4=y
CONFIG_ARMV8_MULTIENTRY=y
CONFIG_DISTRO_DEFAULTS=y
# CONFIG_SYS_MALLOC_F is not set
CONFIG_FIT=y
CONFIG_SYS_EXTRA_OPTIONS="IMX_CONFIG=board/freescale/s32-gen1/s32-gen1.cfg"
CONFIG_USE_BOOTARGS=y
CONFIG_ARCH_EARLY_INIT_R=y
CONFIG_BOARD_EARLY_INIT_F=y
CONFIG_CMD_MEMTEST=y
CONFIG_DM=y
# CONFIG_DM_DEVICE_REMOVE is not set
# CONFIG_DM_SEQ_ALIAS is not set
CONFIG_FSL_ESDHC=y
CONFIG_FSL_LINFLEXUART=y
CONFIG_OF_LIBFDT=y
CONFIG_DM_ETH=y
CONFIG_NETDEVICES=y
CONFIG_DWC_ETH_QOS_DEVICES=y
CONFIG_DWC_ETH_QOS_S32CC=y
```

## configs/s32v234bbmini_defconfig
```kconfig
CONFIG_ARM=y
CONFIG_ARCH_S32=y
CONFIG_S32V234BBMINI_29406=y
CONFIG_S32_DDR3=y
CONFIG_ARMV8_MULTIENTRY=y
CONFIG_SYS_EXTRA_OPTIONS="IMX_CONFIG=board/freescale/s32v234evb/s32v234evb.cfg"
CONFIG_CMD_DHCP=y
CONFIG_CMD_PING=y
CONFIG_CMD_SPI=y
CONFIG_FSL_LINFLEXUART=y
CONFIG_FSL_DSPI=y
CONFIG_SJA1105=y
CONFIG_FSL_CSE3=y
```

## configs/s32v234ccpb_defconfig
```kconfig
CONFIG_ARM=y
CONFIG_ARCH_S32=y
CONFIG_SYS_TEXT_BASE=0x3E820000
CONFIG_TARGET_S32V234CCPB=y
CONFIG_S32_DDR3=y
CONFIG_ARMV8_MULTIENTRY=y
CONFIG_DISTRO_DEFAULTS=y
CONFIG_SYS_EXTRA_OPTIONS="IMX_CONFIG=board/freescale/s32v234ccpb/s32v234ccpb.cfg"
CONFIG_USE_BOOTARGS=y
CONFIG_ARCH_EARLY_INIT_R=y
CONFIG_BOARD_EARLY_INIT_F=y
CONFIG_CMD_MEMTEST=y
CONFIG_CMD_SPI=y
CONFIG_ENV_IS_IN_MMC=y
CONFIG_DM=y
CONFIG_FSL_CSE3=y
CONFIG_FSL_ESDHC=y
CONFIG_PHYLIB=y
CONFIG_PHY_MICREL=y
CONFIG_PHY_MICREL_KSZ90X1=y
CONFIG_NETDEVICES=y
CONFIG_FSL_LINFLEXUART=y
CONFIG_SPI=y
CONFIG_FSL_DSPI=y
CONFIG_SJA1105=y
CONFIG_OF_LIBFDT=y
```

## configs/s32v234evb29288_defconfig
```kconfig
CONFIG_ARM=y
CONFIG_ARCH_S32=y
CONFIG_TARGET_S32V234EVB=y
CONFIG_S32V234EVB_29288=y
CONFIG_S32_DDR3=y
CONFIG_ARMV8_MULTIENTRY=y
CONFIG_SYS_EXTRA_OPTIONS="IMX_CONFIG=board/freescale/s32v234evb/s32v234evb.cfg"
CONFIG_CMD_DHCP=y
CONFIG_CMD_PING=y
CONFIG_CMD_SPI=y
CONFIG_FSL_LINFLEXUART=y
CONFIG_FSL_CSE3=y
CONFIG_FSL_DSPI=y
CONFIG_SJA1105=y
```

## configs/s32v234evb_defconfig
```kconfig
CONFIG_ARM=y
CONFIG_TARGET_S32V234EVB=y
CONFIG_ARMV8_MULTIENTRY=y
CONFIG_SYS_EXTRA_OPTIONS="IMX_CONFIG=board/freescale/s32v234evb/s32v234evb.cfg"
CONFIG_CMD_DHCP=y
CONFIG_CMD_PING=y
CONFIG_FSL_LINFLEXUART=y
```

## configs/s32v234evbbcm_defconfig
```kconfig
CONFIG_ARM=y
CONFIG_ARCH_S32=y
CONFIG_TARGET_S32V234EVB=y
CONFIG_SYS_TEXT_BASE=0x3E820000
CONFIG_S32V234EVB_28899=y
CONFIG_ARMV8_MULTIENTRY=y
CONFIG_PHY_RGMII_DIRECT_CONNECTED=y
CONFIG_SYS_EXTRA_OPTIONS="IMX_CONFIG=board/freescale/s32v234evb/s32v234evb.cfg"
CONFIG_FSL_LINFLEXUART=y
CONFIG_FSL_CSE3=y
CONFIG_DISTRO_DEFAULTS=y
CONFIG_BOARD_EARLY_INIT_F=y
```

## configs/s32v234fvb_defconfig
```kconfig
CONFIG_ARM=y
CONFIG_TARGET_S32V234FVB=y
CONFIG_SYS_EXTRA_OPTIONS="IMX_CONFIG=board/freescale/s32v234fvb/s32v234fvb.cfg"
```

## configs/s32v234fvb_revb_defconfig
```kconfig
CONFIG_ARM=y
CONFIG_ARCH_S32=y
CONFIG_TARGET_S32V234FVB=y
CONFIG_ARMV8_MULTIENTRY=y
CONFIG_SYS_EXTRA_OPTIONS="IMX_CONFIG=board/freescale/s32v234fvb/s32v234fvb.cfg"
CONFIG_CMD_DHCP=y
CONFIG_CMD_PING=y
CONFIG_FSL_LINFLEXUART=y
CONFIG_FSL_CSE3=y
```

## configs/s32v234pcie_defconfig
```kconfig
CONFIG_ARM=y
CONFIG_ARCH_S32=y
CONFIG_TARGET_S32V234PCIE=y
CONFIG_SYS_TEXT_BASE=0x3E820000
CONFIG_ARMV8_MULTIENTRY=y
CONFIG_SYS_EXTRA_OPTIONS="IMX_CONFIG=board/freescale/s32v234pcie/s32v234pcie.cfg"
CONFIG_FSL_LINFLEXUART=y
CONFIG_FSL_LINFLEX_MODULE=1
CONFIG_FSL_CSE3=y
CONFIG_DISTRO_DEFAULTS=y
```

## configs/s32v234pciebcm_defconfig
```kconfig
CONFIG_ARM=y
CONFIG_ARCH_S32=y
CONFIG_TARGET_S32V234PCIE=y
CONFIG_ARMV8_MULTIENTRY=y
CONFIG_PHY_RGMII_DIRECT_CONNECTED=y
CONFIG_SYS_CONFIG_NAME="s32v234pcie"
CONFIG_SYS_EXTRA_OPTIONS="IMX_CONFIG=board/freescale/s32v234pcie/s32v234pcie.cfg"
CONFIG_CMD_DHCP=y
CONFIG_CMD_PING=y
CONFIG_FSL_LINFLEXUART=y
CONFIG_FSL_LINFLEX_MODULE=1
CONFIG_FSL_CSE3=y
```

## configs/s32v234sbc_defconfig
```kconfig
CONFIG_ARM=y
CONFIG_ARCH_S32=y
CONFIG_TARGET_MPXS32V234=y
CONFIG_SYS_TEXT_BASE=0x3E820000
CONFIG_S32_DDR3=y
CONFIG_ARMV8_MULTIENTRY=y
CONFIG_SYS_EXTRA_OPTIONS="IMX_CONFIG=board/freescale/s32v234evb/s32v234evb.cfg"
CONFIG_FSL_CSE3=y
CONFIG_FSL_LINFLEXUART=y
CONFIG_DISTRO_DEFAULTS=y
CONFIG_BOARD_EARLY_INIT_F=y
```

## configs/s32v234tmdp_defconfig
```kconfig
CONFIG_ARM=y
CONFIG_ARCH_S32=y
CONFIG_TARGET_S32V234TMDP=y
CONFIG_PHY_RGMII_DIRECT_CONNECTED=y
CONFIG_ARMV8_MULTIENTRY=y
CONFIG_SYS_EXTRA_OPTIONS="IMX_CONFIG=board/freescale/s32v234tmdp/s32v234tmdp.cfg"
CONFIG_CMD_DHCP=y
CONFIG_CMD_PING=y
CONFIG_FSL_LINFLEXUART=y
CONFIG_FSL_CSE3=y
```

## configs/s32v244_defconfig
```kconfig
CONFIG_ARM=y
CONFIG_ARCH_S32V244=y
CONFIG_ARMV8_MULTIENTRY=y
CONFIG_SYS_EXTRA_OPTIONS="IMX_CONFIG=board/freescale/s32v244evb/s32v244evb.cfg"
CONFIG_CMD_DHCP=y
CONFIG_CMD_PING=y
CONFIG_FSL_LINFLEXUART=y
```

## configs/s32v344_defconfig
```kconfig
CONFIG_ARM=y
CONFIG_ARCH_S32=y
CONFIG_TARGET_S32V344=y
CONFIG_S32_LPDDR4=y
CONFIG_ARMV8_MULTIENTRY=y
CONFIG_SYS_EXTRA_OPTIONS="IMX_CONFIG=board/freescale/s32-gen1/s32-gen1.cfg"
CONFIG_CMD_DHCP=y
CONFIG_CMD_PING=y
CONFIG_FSL_LINFLEXUART=y
CONFIG_FIT=y
```

## configs/s32v344_sim_defconfig
```kconfig
CONFIG_ARM=y
CONFIG_ARCH_S32=y
CONFIG_SYS_TEXT_BASE=0x380a0000
CONFIG_ENV_SIZE=0x2000
CONFIG_NR_DRAM_BANKS=3
CONFIG_TARGET_S32V344SIM=y
CONFIG_S32_LPDDR4=y
CONFIG_SYS_DATA_BASE=0x38000000
CONFIG_DISTRO_DEFAULTS=y
CONFIG_FIT=y
CONFIG_USE_BOOTARGS=y
CONFIG_ARCH_EARLY_INIT_R=y
CONFIG_BOARD_EARLY_INIT_F=y
CONFIG_CMD_MEMTEST=y
CONFIG_FSL_LINFLEXUART=y
CONFIG_OF_LIBFDT=y
```

## configs/sac58revb_defconfig
```kconfig
CONFIG_SYS_EXTRA_OPTIONS="IMX_CONFIG=board/freescale/sac58r/sac58r.cfg,DDR_MB=128"
CONFIG_ARM=y
CONFIG_TARGET_SAC58R=y
```

## configs/sac58rfvb_defconfig
```kconfig
CONFIG_SYS_EXTRA_OPTIONS="IMX_CONFIG=board/freescale/sac58rfvb/sac58r_mt41j64.cfg,DDR_MB=1024"
CONFIG_ARM=y
CONFIG_TARGET_SAC58RFVB=y
```

## drivers/crypto/fsl/Kconfig
```kconfig
config FSL_CAAM
	bool "Freescale Crypto Driver Support"
	help
	  Enables the Freescale's Cryptographic Accelerator and Assurance
	  Module (CAAM), also known as the SEC version 4 (SEC4). The driver uses
	  Job Ring as interface to communicate with CAAM.

config FSL_CSE3
	bool "Freescale CSE3 Crypto Engine support"
	help
	  Enables Freescale's Cryptographic Services Engine (CSE3).
```
