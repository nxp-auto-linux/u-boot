## arch/arm/mach-s32/s32g3/Kconfig
```kconfig
# SPDX-License-Identifier: GPL-2.0+
# Copyright 2022-2024 NXP

if ARCH_S32G3

choice
	prompt "S32G3 board select"
	default TARGET_S32G399ARDB3

config TARGET_S32G399ARDB3
	bool "Support S32G399ARDB3 board"
	help
	  This board is based on S32G399A SoC. It is equipped with
	  4 GB of RAM, 64MB of QSPI memory, 6 Ethernet Ports, PCIe slot,
	  serial port, 18 CAN ports, I2C and DSPI.
	imply CMD_EEPROM
	imply I2C_EEPROM
	imply MMC_UHS_SUPPORT
	select NXP_S32GRDB_BOARD

config TARGET_S32G3XXAEVB
	bool "Support S32G3-EVB board"
	help
	  This board is based on S32G3 family of SoCs. It is equipped with
	  4 GB of RAM, 64MB of QSPI memory, PCIe slot, USB, serial port,
	  I2C and DSPI.
	imply DM_USB
	imply SAF1508BET_USB_PHY
	imply USB
	imply USB_EHCI_HCD
	imply USB_ULPI
	select NXP_S32GEVB_BOARD

config TARGET_S32G3XXAEVB3
	bool "Support S32G3-EVB3 board"
	help
	  This board is based on S32G3 family of SoCs. It is equipped with
	  4 GB of RAM, 64MB of QSPI memory, PCIe slot, USB, serial port,
	  I2C and DSPI.
	select NXP_S32GEVB3_BOARD

config TARGET_S32G399ASOM
	bool "Support S32G3-VC-SOM board"
	help
	  This board is based on S32G3 family of SoCs. It is equipped with
	  4 GB of RAM, 64MB of QSPI memory, PCIe slot, serial port.
	  It is intended to be used in conjunction with other S32 based SoCs,
	  through PCIe and Ethernet connections.
	imply ADC
	imply CMD_EEPROM
	imply CMD_PMIC
	imply DM_PMIC
	imply DM_PMIC_VR5510
	imply I2C_EEPROM
	imply NXP_S32CC_BOARD_COMMON
	imply PHY
	imply PHY_MICREL
	imply PHY_MICREL_KSZ90X1
	imply SARADC_S32CC
	select SPI_FLASH_MACRONIX
	select SPI_FLASH_MX25UW51245G
	select SPI_FLASH_SOFT_RESET
	select SPI_FLASH_SOFT_RESET_ON_BOOT
	select NXP_S32G3VCSOM_BOARD

config TARGET_S32G399ABASE
	bool "Support S32G3-VC-BASE board"
	help
	  This board is based on S32G3 family of SoCs. It is equipped with
	  4 GB of RAM, 64MB of QSPI memory, 6 Ethernet Ports, 2 Generic PCIe slots,
	  2 M.2 PCIe slots, 8 LLCE CAN ports, serial port, I2C and DSPI.
	  It is intended to be used as a base board in conjunction with
	  up to 4 S32 based SOM boards, connected through dedicated PCIe and Ethernet
	  interfaces.
	imply ADC
	imply CMD_EEPROM
	imply CMD_PMIC
	imply DM_PMIC
	imply DM_PMIC_VR5510
	imply I2C_EEPROM
	imply NXP_S32CC_BOARD_COMMON
	imply PHY
	imply PHY_MICREL
	imply PHY_MICREL_KSZ90X1
	imply SARADC_S32CC
	select SPI_FLASH_MACRONIX
	select SPI_FLASH_MX25UW51245G
	select SPI_FLASH_SOFT_RESET
	select SPI_FLASH_SOFT_RESET_ON_BOOT
	select NXP_S32G3VCBASE_BOARD

config TARGET_S32G399AEMU
	bool "Support S32G399A ZeBu"
	select TARGET_TYPE_S32CC_EMULATOR

endchoice

config NXP_PFENG
	default y if !TARGET_TYPE_S32CC_EMULATOR

source "board/nxp/s32-cc/s32g/Kconfig"
source "board/nxp/s32g399ardb3/Kconfig"
source "board/nxp/s32g3xxaevb/Kconfig"
source "board/nxp/s32g3xxaevb3/Kconfig"
source "board/nxp/s32g399asom/Kconfig"
source "board/nxp/s32g399abase/Kconfig"
source "board/nxp/s32g399aemu/Kconfig"

endif
```

## arch/arm/mach-s32/s32r45/Kconfig
```kconfig
# SPDX-License-Identifier: GPL-2.0+
# Copyright 2022-2023 NXP

if ARCH_S32R45

choice
	prompt "S32R45 board select"
	default TARGET_S32R45EVB

config TARGET_S32R45EVB
	bool "Support S32R45EVB board"
	help
	  This board is based on S32R45 SoC. Is is equipped with
	  4GB of RAM, 64MB of QSPI memory, PCIe slot, serial port,
	  I2C and DSPI.
	imply ADC
	imply CMD_EEPROM
	imply I2C_EEPROM
	imply NXP_S32CC_BOARD_COMMON
	imply PHY_AQUANTIA
	imply PHY_FIXED
	imply PHY_MICREL
	imply PHY_MICREL_KSZ90X1
	imply SARADC_S32CC
	select LAST_STAGE_INIT
	select SPI_FLASH_MACRONIX
	select SPI_FLASH_MX25UW51245G
	select SPI_FLASH_SOFT_RESET
	select SPI_FLASH_SOFT_RESET_ON_BOOT

config TARGET_S32R45RENAN
	bool "Support S32R45RENAN board"
	help
	  This board is a NovTech board based on S32R45 SoC.
	imply ADC
	imply CMD_EEPROM
	imply I2C_EEPROM
	imply NXP_S32CC_BOARD_COMMON
	imply SARADC_S32CC
	imply RGMII
	imply NVME
	imply PHY_XWAY
	select ID_EEPROM
	select BOARD_EARLY_INIT_R

config TARGET_S32R45EMU
	bool "Support S32R45 ZeBu"
	select TARGET_TYPE_S32CC_EMULATOR

endchoice

source "board/nxp/s32r45evb/Kconfig"
source "board/nxp/s32r45emu/Kconfig"
source "board/novtech/s32r45renan/Kconfig"

endif
```

## board/freescale/Kconfig
```kconfig
config SYS_VENDOR
	string
	default "freescale"

config S32_GEN1
	bool "S32 GEN1 Common Chassis"
	imply DM_ETH
	imply DM_I2C
	imply DM_PCI
	imply DM_PMIC
	imply DM_PMIC_VR5510
	imply DM_SPI
	imply DM_SPI_FLASH
	imply DWC_ETH_QOS_DEVICES
	imply DWC_ETH_QOS_S32CC
	imply FSL_DSPI
	imply FSL_LINFLEXUART
	imply FSL_PFENG
	imply FSL_QSPI
	imply FSL_USDHC
	imply MISC
	imply MMC_HS400_ES_SUPPORT
	imply MP
	imply PCI
	imply PCIE_S32GEN1
	imply S32_TIMER
	imply SPI
	imply SYS_I2C_MXC
	imply TIMER
	select ARCH_MISC_INIT
	select ARM_SMCCC
	select BINMAN
	select CLK
	select CLK_SCMI
	select CPU
	select DISTRO_DEFAULTS
	select DM
	select DM_GPIO
	select DM_MMC
	select DM_SERIAL
	select MMC_HS400_SUPPORT
	select OF_CONTROL
	select OF_SEPARATE
	select PINCTRL
	select PINCTRL_FULL
	select PINCTRL_S32
	select S32_GPIO
	select SCMI_FIRMWARE
	select SYSRESET
	select SYSRESET_PSCI
	select SYS_MALLOC_F
	help
	  Platform Selection

config EXTRA_KERNEL_BOOT_ARGS
	string "Additional boot arguments for Linux kernel"
	default ""

config PHY_RGMII_DIRECT_CONNECTED
	bool "Enable fixed PHY for MDIO Bus/PHY emulation with fixed speed/link PHYs"
	default n
	help
	  Adds the platform "fixed" MDIO Bus to cover the boards that
	  use PHYs that are not connected to the real MDIO bus.

config XEN_SUPPORT
	bool "Enable Xen EL2 Booting and set environment variables in order to boot directly into Xen Hypervisor"
	default n
	help
	  Skip the enablement of CONFIG_ARMV8_SWITCH_TO_EL1 and set Xen Image,
	  fdts load addresses and u-boot environment variables in order for u-boot
	  to directly load the Xen Image which will use a given Kernel Image as
	  Dom0.

source "board/freescale/s32-gen1/Kconfig"
```

## board/freescale/campps32v2/Kconfig
```kconfig
if TARGET_CAMPPS32V2

config SYS_BOARD
	string
	default "campps32v2"

config SYS_CONFIG_NAME
	string
	default "campps32v2"

config PHY_RGMII_DIRECT_CONNECTED
	bool "Enable fixed PHY for MDIO Bus/PHY emulation with fixed speed/link PHYs"
	default n
	help
	  Adds the platform "fixed" MDIO Bus to cover the boards that
	  use PHYs that are not connected to the real MDIO bus.

config S32V234_FAST_BOOT
	bool "Configure DCD and RUNMODE for a fast-boot efused board"
	default n
	help
	  Configure DCD and RUNMODE for a board that has been efused such that
	  OCOTP_CFG6:[19]FAST_BOOT_ENABLE = 0 and OCOTP_CFG6:[18]NO_PLL = 1.

config XEN_SUPPORT
	bool "Enable Xen EL2 Booting and set environment variables in order to boot directly into Xen Hypervisor"
	default n
	help
	  Skip the enablement of CONFIG_ARMV8_SWITCH_TO_EL1 and set Xen Image,
	  fdts load addresses and u-boot environment variables in order for u-boot
	  to directly load the Xen Image which will use a given Kernel Image as
	  Dom0.

endif
```

## board/freescale/s32-gen1/Kconfig
```kconfig
if TARGET_S32G274AEMU || TARGET_S32R45EMU || TARGET_S32G399AEMU

config TARGET_TYPE_S32GEN1_EMULATOR
	bool
	default y
	help
	  Target Type S32 Gen1 Emulator

endif

if TARGET_S32G274ASIM || TARGET_S32R45SIM

config TARGET_TYPE_S32GEN1_SIMULATOR
	bool
	default y
	help
	  Target Type S32 Gen1 Simulator

endif

config S32GEN1_SET_NEAREST_FREQ
	bool "Set the frequency to the nearest available"
	default n
	help
	  Select this config to allow the clock driver to set
	  the nearest frequency for a clock if the requested
	  one cannot be set. In both cases, an error will be
	  printed with the targeted and the actual frequency.

config S32GEN1_DRAM_INLINE_ECC
	bool "S32 GEN1 inline ECC"
	default y if !TARGET_TYPE_S32GEN1_EMULATOR
	help
	  Select this config if you want to use inline ECC feature for
	  S32 Gen1 boards.

config CUSTOM_SYS_DATA_BASE
	bool "Use a custom SYS_DATA_BASE address"
	help
	  Enable this if you need to define a custom SYS_DATA_BASE address.
	  When disabled, a suitable SYS_DATA_BASE address is calculated
	  automatically.

config SYS_DATA_BASE
	hex "Data Base" if CUSTOM_SYS_DATA_BASE
	default 0xbfa00000 if S32_ATF_BOOT_FLOW && TARGET_TYPE_S32GEN1_EMULATOR
	default 0xffa00000 if S32_ATF_BOOT_FLOW
	default 0x34000000
	help
	  U-boot data base address (normally SRAM base address)

config CUSTOM_SYS_TEXT_BASE
	bool "Use a custom SYS_TEXT_BASE"
	help
	  Enable this if you need to use a custom SYS_TEXT_BASE address.
	  When disabled, a suitable SYS_TEXT_BASE address will be calculated
	  automatically.

config SYS_TEXT_BASE
	hex "Text Base" if CUSTOM_SYS_TEXT_BASE
	default 0xbfaa0000 if S32_ATF_BOOT_FLOW && TARGET_TYPE_S32GEN1_EMULATOR
	default 0xffaa0000 if S32_ATF_BOOT_FLOW
	default 0x340a0000

config SYS_MEM_SIZE
	hex "RAM Memory Size"
	default 0x00800000
	help
	  U-boot SRAM size (8 MB for Gen1)

config SYS_BOARD
	string
	default "s32-gen1"

config SYS_CONFIG_NAME
	string
	default "s32g274a" if NXP_S32G2XX
	default "s32r45" if NXP_S32R45
	default "s32g399a" if NXP_S32G3XX

config SYS_ERRATUM_ERR050543
	bool "Workaround for NXP Erratum ERR050543"
	default y if (NXP_S32G2XX || NXP_S32R45) && \
			!TARGET_TYPE_S32GEN1_EMULATOR
	help
	  This option enables a workaround for NXP Erratum ERR050543
	  (This erratum applies for LPDDR4 memories only. The memories require
	  a periodic refresh to maintain memory contents and the refresh rate
	  has to vary over temperature and S32G contains an hardware-based
	  automatism to carry this dynamic adjustment out. This automatism however
	  does not work under all conditions.)

# Size of SRAM area used by U-boot during the first boot stage. This includes
# all of the sections in the System.map, plus the runtime stack which
# is constructed starting from this offset downwards. Note this has nothing
# to do with the memory layout after relocation to DDR, which includes
# heap and other zones reservations.
config UBOOT_SRAM_FOOTPRINT
	hex
	default 0x200000

config CUSTOM_DTB_SRAM_ADDR
	bool "Use a custom DTB_SRAM_ADDR"
	help
	  Enable this if you need to use a custom DTB_SRAM_ADDR.
	  When disabled, a suitable DTB_SRAM_ADDR address is calculated
	  automatically.

config DTB_SRAM_ADDR
	hex "SRAM address at which the dtb will be found" if CUSTOM_DTB_SRAM_ADDR
	default 0xbfa90000 if S32_ATF_BOOT_FLOW && TARGET_TYPE_S32GEN1_EMULATOR
	default 0xffa90000 if S32_ATF_BOOT_FLOW
	default 0x34090000

choice
	prompt "Select boot flow configuration"
	default S32_STANDALONE_BOOT_FLOW
	help
	  In secure boot and power management aware scenarios, there would be a
	  Trusted Firmware running at EL3 just before U-Boot, while the latter
	  runs at EL2 or EL1. Running in the non-secure world prevents U-Boot
	  from configuring certain registers, in particular secure GICv3.
	  While the secure boot feature and the Trusted Firmware are still in
	  development, this choice will enable the U-Boot and firmware developer
	  to switch between TF-A and standalone boot flows. The default
	  is standalone, to allow for backward compatibility with the existing,
	  stable configurations.

	config S32_STANDALONE_BOOT_FLOW
		bool "Standalone boot flow"
		help
		  U-Boot runs at EL3 as the first component in the boot flow.
		  This boot flow does not accommodate an ARM Trusted Firmware
		  (TF-A) for this platform.

	config S32_ATF_BOOT_FLOW
		bool "Boot flow with TF-A"
		select S32_SKIP_RELOC
		help
		  U-Boot is started by the ARM Trusted Firmware (TF-A) and runs
		  in the non-secure world.
endchoice

config S32GEN1_HWCONFIG
	string "S32GEN1 HWConfig definition"
	depends on S32_GEN1 && (PCIE_S32GEN1 || FSL_PFENG)
	default "pcie0:mode=rc,clock=ext;pcie1:mode=sgmii,clock=ext,fmhz=125,xpcs_mode=2G5" if (PCIE_S32GEN1 && FSL_PFENG) &&  TARGET_S32G274ARDB
	default "pcie0:mode=rc,clock=ext;pcie1:mode=sgmii,clock=ext,fmhz=125,xpcs_mode=0" if (PCIE_S32GEN1 && FSL_PFENG) &&  (TARGET_S32G2XXAEVB || TARGET_S32G3XXAEVB)
	default "pcie0:mode=ep,clock=ext;pcie1:mode=sgmii,clock=ext,fmhz=125,xpcs_mode=0" if (PCIE_S32GEN1 && FSL_PFENG) &&  TARGET_S32G274ABLUEBOX3
	default "pcie0:mode=sgmii;pcie1:mode=sgmii" if (!PCIE_S32GEN1 && FSL_PFENG)
	default "pcie0:mode=rc,clock=ext;pcie1:mode=ep,clock=int" if (PCIE_S32GEN1 && !FSL_PFENG)
	default ""
	help
	  The configuration for the PCIe controllers, stored in
	  the variable 'hwconfig'
	  It configures the mode (rc, ep, sgmii) or the clock type
	  (internal or external)
	  It is also possible to configure combo mode either ep&sgmii or
	  rc&sgmii, with these configurations lane0 is PCIe and lane1
	  is connected to mac depending on 'xpcs_mode'.
	  SGMII uses additional configurations 'fmhz' and 'xpcs_mode'.
	  Config 'xpcs_mode' is used to specifically configure each line in
	  SGMII mode. The following are valid options: '2G5', 'both', '0' and
	  '1'. Mode '2G5' uses lane0 in 2.5G mode and leaves lane1 disabled.
	  Mode 'both' configures both lanes for 1G operation so 2 macs can
	  be connected. Mode '0' is used to configure only XPCS0, this can be
	  used in 'sgmii' mode (one lane emac 1G other lane disabled) or
	  in 'rc&sgmii'/'ep&sgmii' (one lane PCIeX1 other lane SGMII 1G).
	  Same configuration is used for '1', which corresponds to XPCS1.
	  Config 'fmhz' specifies frequency used as reference. In case of
	  2.5G mode it is required to set this 125, if used in SGMII/PCIe
	  combo mode 'fmhz' has to be 100 (PCIe ignores this and always
	  uses 100). In case the SerDes is configured as SGMII and not in
	  2.5G mode either 100 or 125 can be used in 'fmhz'.
	  Available 'xpcs_mode' are depedent on platform:
	  	s32g274a - supports '0','1','both' and '2G5'
	  	s32r45   - supports '0' and '2G5'

config S32GEN1_CONFIG_FILE
	string
	default "board/freescale/s32-gen1/s32gen1.cfg"
```

## board/freescale/s32v234ccpb/Kconfig
```kconfig
if TARGET_S32V234CCPB

config SYS_BOARD
	string
	default "s32v234ccpb"

config SYS_CONFIG_NAME
	string
	default "s32v234ccpb"

endif
```

## board/freescale/s32v234evb/Kconfig
```kconfig
if TARGET_S32V234EVB

config SYS_BOARD
	string
	default "s32v234evb"

config SYS_CONFIG_NAME
	string
	default "s32v234bbmini" if S32V234BBMINI_29406
	default "s32v234evb29288" if S32V234EVB_29288
	default "s32v234evb28899" if S32V234EVB_28899

endif
```

## board/freescale/s32v234fvb/Kconfig
```kconfig
if TARGET_S32V234FVB

config SYS_BOARD
	string
	default "s32v234fvb"

config SYS_CONFIG_NAME
	string
	default "s32v234fvb"

# S32V234FVB board with DDR3 has 4x512 MB DDR chips,
# DDR0(1GB) and DDR1(1GB).
# S32V234FVB board with LPDDR2 has 2*256MB DDR chips,
# DDR0(256MB) and DDR1(256MB).
# U-boot uses only one DDR slot.
config SYS_DDR_SIZE
	int
	default 1073741824 if S32_DDR3
	default 268435456  if S32_LPDDR2

config S32V234_FAST_BOOT
	bool "Configure DCD and RUNMODE for a fast-boot efused board"
	default n
	help
	  Configure DCD and RUNMODE for a board that has been efused such that
	  OCOTP_CFG6:[19]FAST_BOOT_ENABLE = 0 and OCOTP_CFG6:[18]NO_PLL = 1.

endif
```

## board/freescale/s32v234hpcsom/Kconfig
```kconfig
if TARGET_S32V234HPCSOM

config SYS_BOARD
	string
	default "s32v234hpcsom"

config SYS_CONFIG_NAME
	string
	default "s32v234hpcsom"
endif

config S32V234_HWCONFIG
	string "S32V234 HWConfig definition"
	default "pcie:mode=ep,clock=ext"

	help
	  The configuration for the PCIe controllers, stored in
	  the variable 'hwconfig'
```

## board/freescale/s32v234pcie/Kconfig
```kconfig
if TARGET_S32V234PCIE

config SYS_BOARD
	string
	default "s32v234pcie"

config SYS_CONFIG_NAME
	string
	default "s32v234pcie"

endif
```
