## Documentation/devicetree/bindings/pci/nxp,s32-pcie.txt
```
* NXP S32 CC PCIe interface *

This PCIe host controller is based on the Synopsys DesignWare PCIe IP
and thus inherits all the common properties defined in designware-pcie.txt.

Required properties:
- compatible:
	- "nxp,s32cc-pcie", for S32Gen1 SoCs (generic)
	- "nxp,s32r45-pcie", for S32R45 SoCs in particular
- reg: base address and length of the PCIe controller
- device_type: must be "pci";

Optional:
- serdes-handle: handle to the corresponding SerDes alias, if the PCIe
	controller has a dependency on other SerDes modules (e.g. PHYs);
- device_id: Id of the devide, starting from 0, when there are more than one;
- num-lanes: Number of lanes (default 1)
- link-speed: Link speed (default 1 = Gen1);
- ranges: Information used for address translation on the PCIe host bus
	(see https://elinux.org/Device_Tree_Usage#PCI_Address_Translation)

Example:

	pcie0: pcie@40400000 {
		compatible = "nxp,s32cc-pcie";
		reg =
			<0x00 0x40400000 0x0 0x80000   /* dbi registers */
			/* configuration space, 4KB each for cfg0 and cfg1
			 * at the end of the outbound memory map
			 */
			0x5f 0xffffe000 0x0 0x00002000>;
		reg-names = "dbi", "config";
		#address-cells = <3>;
		#size-cells = <2>;
		device_type = "pci";
		serdes-handle = <&serdes0>;
		device_id = <0>;
		num-lanes = <2>; /* supports max 2 lanes */
		link-speed = <3>; /* supports Gen3 speed */

		bus-range = <0x0 0xff>;
		ranges =
			/* downstream I/O, 64KB and aligned naturally just before
			 * the config space to minimize fragmentation
			 */
			<0x81000000 0x0 0x00000000 0x5f 0xfffe0000 0x0 0x00010000
			/* non-prefetchable memory, with best case size
			 * and alignment
			 */
			 0x82000000 0x0 0x00000000 0x58 0x00000000 0x7 0xfffe0000>;
		status = "disabled";
	};
```

## arch/arm/cpu/armv8/s32/Kconfig
```kconfig
if ARCH_S32

config SYS_SOC
	string
	default "s32"

config BAUDRATE
	int "Serial baudrate"
	default 115200

config NXP_S32G2XX
	bool
	select S32_GEN1
	help
	  Platforms having S32G2XXX SoC

config NXP_S32G3XX
	bool
	select S32_GEN1
	help
	  Platforms having S32G3XXX SoC

config NXP_S32R45
	bool
	select S32_GEN1
	help
	  Platforms having S32R45 SoC

choice
	prompt "Select S32 Target Board Support"
	default TARGET_S32G274ARDB2
	help
	  S32 Target Board Selection

config TARGET_S32R45EVB
	bool "Support s32r45evb"
	imply ADC
	imply I2C_EEPROM
	imply PHY_AQUANTIA
	imply S32_SARADC
	select NXP_S32R45
	select SPI_FLASH_MACRONIX

config TARGET_S32R45EMU
	bool "Support s32r45 ZeBu"
	select NXP_S32R45

config TARGET_S32G2XXAEVB
	bool "Support s32g274aevb"
	imply ADC
	imply DM_USB
	imply I2C_EEPROM
	imply PHY
	imply PHY_AQUANTIA
	imply PHY_MICREL
	imply PHY_MICREL_KSZ90X1
	imply S32_SARADC
	imply SAF1508BET_USB_PHY
	imply SJA1105
	imply USB
	imply USB_EHCI_HCD
	select MISC_INIT_R if SJA1105
	select NXP_S32G2XX
	select SPI_FLASH_MACRONIX

config TARGET_S32G274ARDB2
	bool "Support s32g274ardb2"
	imply DM_PMIC_PF5020
	imply DM_PMIC_FS5600
	imply PHY_ATHEROS
	imply PHY_MICREL
	imply PHY_MICREL_KSZ90X1
	select ADC
	select NXP_S32G2XX
	select S32_SARADC
	select SPI_FLASH_MACRONIX

config TARGET_S32G274ABLUEBOX3
	bool "Support s32g274abluebox3"
	imply ADC
	imply I2C_EEPROM
	imply PHY
	imply PHYLIB
	imply S32_SARADC
	select NXP_S32G2XX
	select SPI_FLASH_STMICRO
	help
	  Enable Microsys S32G SoM Bluebox 3 target.
	  S32G works as PCIE EP.

config TARGET_S32G274AEMU
	bool "Support s32g274a ZeBu"
	select NXP_S32G2XX

config TARGET_S32G399AEMU
	bool "Support S32G399A ZeBu"
	select NXP_S32G3XX

config TARGET_S32G3XXAEVB
	bool "Support for S32G3 EVB boards"
	imply ADC
	imply DM_USB
	imply I2C_EEPROM
	imply PHY
	imply PHY_AQUANTIA
	imply PHY_MICREL
	imply PHY_MICREL_KSZ90X1
	imply S32_SARADC
	imply SAF1508BET_USB_PHY
	imply SJA1105
	imply USB
	imply USB_EHCI_HCD
	select NXP_S32G3XX
	select SPI_FLASH_MACRONIX

config TARGET_S32G399ARDB3
	bool "Support s32g399ardb3"
	imply DM_PMIC_PF5020
	imply DM_PMIC_FS5600
	imply I2C_EEPROM
	imply PHY_ATHEROS
	imply PHY_MICREL
	imply PHY_MICREL_KSZ90X1
	select ADC
	select NXP_S32G3XX
	select S32_SARADC
	select SPI_FLASH_MACRONIX

endchoice

config S32_CMU
	bool "Enable Clock Monitoring Unit-Frequency Check"
	default y
	depends on S32_GEN1
	help
	  Checks if the frequency of a monitored clock (monitored_clock)
	  is within a programmable frequency range specified by the user.

config BOARD_NFS_BOOT_INTERFACE
	string "Board NFS Boot Interface"
	default "br0" if TARGET_S32G274ABLUEBOX3
	default "eth0"

source "board/nxp/Kconfig"

endif
```

## arch/arm/cpu/armv8/s32/s32-gen1/Kconfig
```kconfig
config CMD_HSE_ADVANCED_SECBOOT
	bool "HSE - Advanced Secure Boot"
	depends on HSE_SECBOOT
	help
	  Use HSE-provided advanced secure boot, SMR-based
```

## arch/arm/cpu/armv8/s32v234/Kconfig
```kconfig
if ARCH_S32V234

config SYS_CPU
	string
	default "armv8"

config SYS_VENDOR
	string
	default "freescale"

config SYS_SOC
	string
	default "s32v234"

config BAUDRATE
	int "Serial baudrate"
	default 115200

choice
	prompt "Select S32V234 Target Board Support"
	default TARGET_S32V234EVB
	help
	  S32V234 Target Board Selection

config TARGET_S32V234EVB
	bool "Support s32v234evb"

config TARGET_S32V234FVB
	bool "Support s32v234fvb"

config TARGET_S32V234PCIE
	bool "Support s32v234pcie"

config TARGET_S32V234TMDP
	bool "Support s32v234tmdp"

endchoice

if TARGET_S32V234EVB

choice
	prompt "S32V234EVB Board Family Member"
	default S32V234EVB_29288
	help
	  S32V234EVB Board Family Members

config S32V234EVB_28899
	bool "S32V234EVB_28899"

config S32V234EVB_29288
	bool "S32V234EVB_29288"

config S32V234BBMINI_29406
	bool "S32V234BBMINI_29406"

endchoice

endif

choice
	prompt "Select DDR type"
	default S32V234_LPDDR2
	help
	  S32V234 DDR Configuration

config S32V234_LPDDR2
	bool "LPDDR2 Support"
	help
	  Enable the support for Micron LPDDR2

config S32V234_DDR3
	bool "DDR3 Support"
	help
	  Enable the support for Micron DDR3

endchoice

config DDR_HANDSHAKE_AT_RESET
	bool "Enable DDR handshake"
	default y
	help
	  Enable DDR handshake after functional reset

source "board/freescale/s32v234evb/Kconfig"
source "board/freescale/s32v234fvb/Kconfig"
source "board/freescale/s32v234pcie/Kconfig"
source "board/freescale/s32v234tmdp/Kconfig"

endif
```

## arch/arm/cpu/armv8/s32v244/Kconfig
```kconfig
if ARCH_S32V244

config SYS_CPU
	string
	default "armv8"

config SYS_VENDOR
	string
	default "freescale"

config SYS_SOC
	string
	default "s32v244"

config BAUDRATE
	int "Serial baudrate"
	default 115200

config DDR_HANDSHAKE_AT_RESET
	bool "Enable DDR handshake"
	default y
	help
	  Enable DDR handshake after functional reset

source "board/freescale/s32v244evb/Kconfig"

endif
```

## arch/arm/mach-s32/Kconfig
```kconfig
# SPDX-License-Identifier: GPL-2.0+
# Copyright 2022 NXP

config MACH_S32
	bool
	select ARM64
	select DM

config SYS_VENDOR
	string
	default "nxp"

config NXP_S32CC
	bool
	imply CMD_DHCP
	imply CMD_EXT2
	imply CMD_EXT4
	imply CMD_FAT
	imply CMD_MDIO
	imply CMD_MII
	imply CMD_MTD
	imply CMD_PART
	imply CMD_PING
	imply DM_ETH
	imply DM_I2C
	imply DOS_PARTITION
	imply DWC_ETH_QOS_S32CC
	imply EFI_LOADER
	imply EFI_LOADER_BOUNCE_BUFFER
	imply FSL_DSPI
	imply FS_FAT
	imply MISC
	imply MP
	imply NET_RANDOM_ETHADDR
	imply NXP_S32CC_PIT_TIMER
	imply S32CC_CMU
	imply SPI
	imply SYS_I2C_MXC
	imply TIMER
	select CLK
	select CLK_SCMI
	select CPU
	select DM_DEVICE_REMOVE
	select DM_GPIO
	select DM_MTD
	select DM_SPI
	select DM_SPI_FLASH
	select DWC_ETH_QOS
	select FSL_LINFLEXUART
	select FSL_QSPI
	select FSL_QSPI_AHB_FULL_MAP
	select FSL_USDHC
	select HUSH_PARSER
	select MACH_S32
	select MMC_HS400_ES_SUPPORT
	select MMC_HS400_SUPPORT
	select MTD
	select OF_BOARD
	select OF_BOARD_FIXUP
	select OF_CONTROL
	select OF_LIVE
	select OF_SYSTEM_SETUP
	select PINCTRL
	select PINCTRL_FULL
	select PINCTRL_S32CC
	select S32CC_GPIO
	select SCMI_FIRMWARE
	select SPI_FLASH
	select SPI_FLASH_MTD
	select SPI_FLASH_SFDP_SUPPORT
	select SPI_MEM
	select SYSRESET
	select SYSRESET_PSCI

source "arch/arm/mach-s32/s32-cc/Kconfig"
```

## arch/arm/mach-s32/s32-cc/Kconfig
```kconfig
# SPDX-License-Identifier: GPL-2.0+
# Copyright 2022-2023 NXP

if NXP_S32CC

config DEFAULT_DEVICE_TREE
	default "s32cc"

config BUILD_TARGET
	default "u-boot-s32.cfgout"

config SYS_TEXT_BASE
	default 0xffaa0000

config SYS_LOAD_ADDR
	default 0x80000000

config SYS_DATA_BASE
	hex "Data Base"
	default 0xffa00000
	help
	  U-Boot data base address in DDR.

config S32CC_MAX_DTB_SIZE
	hex "Max size reserved for device tree in image layout"
	default 0x8000

config SYS_MALLOC_F_LEN
	default 0x8000

config S32CC_QSPI_FREQ
	int "QSPI frequency setting (MHz) used in order to set BootROM's clock"
	default 200

config BOARD_NFS_BOOT_INTERFACE
	string "Board NFS Boot Interface"
	default "br0" if TARGET_S32G274ABLUEBOX3
	default "eth0"

config S32CC_HWCONFIG
	string "S32CC HWConfig definition"
	depends on PHY_S32CC_SERDES
	default "serdes0:mode=xpcs0&xpcs1,clock=ext,fmhz=125;xpcs0_0:speed=2G5;xpcs0_1:speed=2G5;serdes1:mode=xpcs0&xpcs1,clock=ext,fmhz=125;xpcs1_0:speed=2G5;xpcs1_1:speed=2G5" if (!PCI_S32CC && FSL_PFENG)
	default "serdes0:mode=pcie,clock=ext;pcie0:mode=rc;serdes1:mode=pcie,clock=int;pcie1:mode=ep" if (PCI_S32CC && !FSL_PFENG)
	default "serdes0:mode=pcie,clock=ext;pcie0:mode=rc;serdes1:mode=xpcs0&xpcs1,clock=ext,fmhz=125;xpcs1_0:speed=2G5" if (PCI_S32CC && FSL_PFENG)

	help
	  The configuration for the SerDes modules, stored in
	  the variable 'hwconfig'.
	  It configures generic attributes for 'serdesX', such as 'mode' (see below),
	  the clock type (internal or external),
	  clock frequency 'fmhz' (100 or 125, SGMII only modes), 'pcieX' mode
	  ('rc' or 'ep') and the 'xpcsX_Y' interfaces for any of the two lanes.
	  In the atributes presented above and below, 'X' (0 or 1) is the index
	  of the SerDes module and 'Y' (0 or 1) is the index of the XPCS interface.
	  SerDes 'mode' attribute can be 'pcie' (PCIe only mode), 'pcie&xpcsY' (PCIe
	  and SGMII combo mode), 'xpcs0&xpcs1' (SGMII only mode).
	  For the combo modes 'pcie&xpcsY', lane0 is PCIe and lane1
	  is connected to a GMAC or PFE MAC depending on 'Y' and 'fmhz' (which
	  match a certain SerDes configuration from the SerDes manual).
	  PCIe always works at 100MHz, therefore 'fmhz' is only for SGMII only mode.
	  Config 'xpcsX_Y' is used to specifically configure each of the two SGMII
	  PHYs, by setting the 'speed' (10M, 100M, 1G and 2G5).
	  S32G2 and S32G3 have 1 GMAC running at 1Gbps and 3 PFE MACs, running at
		10Mbps - 2.5Gbps speeds.
	  S32R45 has two GMACs, GMAC0 running at 1Gbps and GMAC1 running at 2.5Gbps.

config S32CC_HWCONFIG_LEGACY
	bool "Legacy S32CC HWConfig definition"
	default y
	depends on PHY_S32CC_SERDES
	help
	  Support for old format for variable HWCONFIG. Each SerDes
	  is identified by the string 'pcieX' and is configured by a list of
	  attributes such as 'mode' (rc, ep, sgmii) and the clock type
	  (internal or external).
	  It is also possible to configure combo modes, either 'ep&sgmii' or
	  'rc&sgmii', with these configurations lane0 is PCIe and lane1
	  is connected to GMAC of PFE mac depending on 'xpcs_mode'.
	  'sgmii' mode uses additional config options 'fmhz' and 'xpcs_mode'.
	  Config 'xpcs_mode' is used to specifically configure each line in
	  SGMII mode. The following are valid options: '2G5', 'both', '0' and
	  '1'. Mode '2G5' uses lane0 in 2.5G mode and leaves lane1 disabled.
	  Mode 'both' configures both lanes for 1G operation so 2 macs can
	  be connected. Mode '0' is used to configure only XPCS0, this can be
	  used in 'sgmii' mode (one lane emac 1G other lane disabled) or
	  in 'rc&sgmii'/'ep&sgmii' (one lane PCIeX1, the other lane SGMII 1G).
	  Same configuration is used for '1', which corresponds to XPCS1.
	  Config 'fmhz' specifies frequency used as reference. In case of
	  2.5G mode it is required to set this 125, if used in SGMII/PCIe
	  combo mode 'fmhz' has to be 100 (PCIe ignores this and always
	  uses 100). In case the SerDes is configured as SGMII and not in
	  2.5G mode either 100 or 125 can be used in 'fmhz'.
	  Available 'xpcs_mode' are dependent on platform:
		s32g274a - supports '0','1','both' and '2G5'
		s32r45   - supports '0' and '2G5'
	  By default, legacy HWCONFIG was:
	  "pcie0:mode=rc,clock=ext;pcie1:mode=sgmii,clock=ext,fmhz=125,xpcs_mode=2G5"
	  This has lots of limitations, and has been redesigned.

config S32CC_CONFIG_FILE
	string
	default "arch/arm/mach-s32/s32-cc/s32cc.cfg"

config TARGET_TYPE_S32CC_EMULATOR
	bool
	default n

config LMB_MAX_REGIONS
	default 16

if TARGET_TYPE_S32CC_EMULATOR
config BAUDRATE
	default 7812500
endif

config ENV_OFFSET
	default 0x1e0000

config SF_DEFAULT_BUS
	default 6

config SF_DEFAULT_CS
	default 0

if SD_BOOT
config ENV_IS_IN_MMC
	default y

config ENV_SIZE
	default 0x2000
endif

if QSPI_BOOT
config ENV_IS_IN_SPI_FLASH
	default y

config ENV_SIZE
	default 0x10000

config ERR051257_WORKAROUND
	bool "ERR051257 erratum workaround"
	default y
	help
	  Enable workaround for ERR051257 erratum.
	  The QSPI boot flow will hang if the QSPI memory will rise any ECC
	  error interrupt. As a software solution for this issue, the pins
	  QSPI_INTA_b and QSPI_INTB_b are configured as GPIO from DCD and the
	  images(QSPI parameters for BootROM, DCD, HSE FW, etc) have an unused
	  space of 1K between them.
endif

config XEN_SUPPORT
	bool "Enable Xen EL2 Booting and set environment variables in order to boot directly into Xen Hypervisor"
	default n
	help
	  Skip the enablement of CONFIG_ARMV8_SWITCH_TO_EL1 and set Xen Image,
	  fdts load addresses and U-Boot environment variables in order for U-Boot
	  to directly load the Xen Image which will use a given Kernel Image as
	  Dom0.

endif

source "arch/arm/mach-s32/s32g2/Kconfig"
source "arch/arm/mach-s32/s32g3/Kconfig"
source "arch/arm/mach-s32/s32r45/Kconfig"
source "board/nxp/s32-cc/Kconfig"
```

## arch/arm/mach-s32/s32g2/Kconfig
```kconfig
# SPDX-License-Identifier: GPL-2.0+
# Copyright 2022-2023 NXP

if ARCH_S32G2

choice
	prompt "S32G2 board select"
	default TARGET_S32G274ARDB2

config TARGET_S32G274ARDB2
	bool "Support S32G274ARDB2 board"
	help
	  This board is based on S32G274A SoC. It is equipped with
	  4 GB of RAM, 64MB of QSPI memory, 6 Ethernet Ports, PCIe slot,
	  USB, serial port, 18 CAN ports, I2C and DSPI.
	select NXP_S32GRDB_BOARD

config TARGET_S32G2XXAEVB
	bool "Support S32G2-EVB board"
	help
	  This board is based on S32G2 family of SoCs. It is equipped with
	  4 GB of RAM, 64MB of QSPI memory, PCIe slot, USB, serial port,
	  I2C and DSPI.
	imply DM_USB
	imply SAF1508BET_USB_PHY
	imply USB
	imply USB_EHCI_HCD
	imply USB_ULPI
	select NXP_S32GEVB_BOARD
	select MISC_INIT_R

config TARGET_S32G2XXAEVB3
	bool "Support S32G2-EVB3 board"
	help
	  This board is based on S32G2 family of SoCs. It is equipped with
	  4 GB of RAM, 64MB of QSPI memory, PCIe slot, USB, serial port,
	  I2C and DSPI.
	select NXP_S32GEVB3_BOARD

config TARGET_S32G274ABLUEBOX3
	bool "Support S32G274A BlueBox3 board"
	help
	  This board is a dual SoC board with S32G2 and LX2,
	  where these two SoCs are connected together via PCIe.
	  Also, this board has rich networking features, such as:
	  PFE, DPAA2 and three sja1110 switches.
	select NXP_S32G274ABLUEBOX3_BOARD

config TARGET_S32G274AEMU
	bool "Support S32G274A ZeBu"
	select TARGET_TYPE_S32CC_EMULATOR

endchoice

config NXP_PFENG
	default y if !TARGET_TYPE_S32CC_EMULATOR

source "board/nxp/s32-cc/s32g/Kconfig"
source "board/nxp/s32g274ardb2/Kconfig"
source "board/nxp/s32g2xxaevb/Kconfig"
source "board/nxp/s32g2xxaevb3/Kconfig"
source "board/nxp/s32g274abluebox3/Kconfig"
source "board/nxp/s32g274aemu/Kconfig"

endif
```
