## board/freescale/s32v234tmdp/Kconfig
```kconfig
if TARGET_S32V234TMDP

config SYS_BOARD
	string
	default "s32v234tmdp"

config SYS_CONFIG_NAME
	string
	default "s32v234tmdp"

# S32V234EVB board with LPDDR2 has 2x256 MB DDR chips
# DDR0(256MB) and DDR1(256MB).
# U-boot uses only one DDR slot.
config SYS_DDR_SIZE
	int
	default 268435456  if S32_LPDDR2

config PHY_RGMII_DIRECT_CONNECTED
	bool "Enable fixed PHY for MDIO Bus/PHY emulation with fixed speed/link PHYs"
	default n
	help
	  Adds the platform "fixed" MDIO Bus to cover the boards that use
	  PHYs that are not connected to the real MDIO bus.

config S32V234_FAST_BOOT
	bool "Configure DCD and RUNMODE for a fast-boot efused board"
	default n
	help
	  Configure DCD and RUNMODE for a board that has been efused such that
	  OCOTP_CFG6:[19]FAST_BOOT_ENABLE = 0 and OCOTP_CFG6:[18]NO_PLL = 1.

endif
```

## board/freescale/s32v244evb/Kconfig
```kconfig
if TARGET_S32V244EVB

config SYS_BOARD
	string
	default "s32v244evb"

config SYS_CONFIG_NAME
	string
	default "s32v244evb"

# DDR0(256MB) and DDR1(256MB).
# U-boot uses only one DDR slot.

config SYS_DDR_SIZE
	int
	default 268435456 if S32V244_LPDDR4

config PHY_RGMII_DIRECT_CONNECTED
	bool "Enable fixed PHY for MDIO Bus/PHY emulation with fixed speed/link PHYs"
	default n
	help
	  Adds the platform "fixed" MDIO Bus to cover the boards that
	  use PHYs that are not connected to the real MDIO bus.

endif
```

## board/freescale/sac58r/Kconfig
```kconfig
if TARGET_SAC58R

config SYS_CPU
	string
	default "armv7"

config SYS_BOARD
	string
	default "sac58r"

config SYS_VENDOR
	string
	default "freescale"

config SYS_SOC
	string
	default "sac58r"

config SYS_CONFIG_NAME
	string
	default "sac58r"

endif
```

## board/freescale/sac58rfvb/Kconfig
```kconfig
if TARGET_SAC58RFVB

config SYS_CPU
	string
	default "armv7"

config SYS_BOARD
	string
	default "sac58rfvb"

config SYS_VENDOR
	string
	default "freescale"

config SYS_SOC
	string
	default "sac58r"

config SYS_CONFIG_NAME
	string
	default "sac58rfvb"

endif
```

## board/microsys/mpxs32v234/Kconfig
```kconfig
# (C) Copyright 2017 MicroSys Electronics GmbH

if TARGET_MPXS32V234

config SYS_BOARD
	string
	default "mpxs32v234"

config SYS_VENDOR
	string
	default "microsys"

config SYS_CONFIG_NAME
	string
	default "s32v234sbc"

config SYS_DATA_BASE
	hex "Data Base"
	default 0x3E800000
	help
	  U-boot data base address (normally SRAM base address)

config SYS_MEM_SIZE
	hex "RAM Memory Size"
	default 0x00400000
	help
	  U-boot SRAM size (4 MB for S32V234)

config EXTRA_KERNEL_BOOT_ARGS
	string "Additional boot arguments for Linux kernel"
	default ""

endif
```

## board/novtech/s32r45renan/Kconfig
```kconfig
# SPDX-License-Identifier: GPL-2.0+
# Copyright 2023 NXP

if TARGET_S32R45RENAN

config SYS_VENDOR
	string
	default "novtech"

config SYS_CONFIG_NAME
	default "s32r45renan"

config SYS_BOARD
	default "s32r45renan"

config NR_DRAM_BANKS
	default 1

if QSPI_BOOT
config ENV_SECT_SIZE
	default 0x10000
endif

config SYS_EEPROM_PAGE_WRITE_DELAY_MS
	default 10

config SYS_EEPROM_SIZE
	default 128

config S32CC_HWCONFIG
	string "S32CC HWConfig definition"
	depends on PHY_S32CC_SERDES
	default "serdes0:mode=pcie,clock=ext;pcie0:mode=rc;serdes1:mode=pcie,clock=ext;pcie1:mode=rc"
	help
	  The configuration for the SerDes modules, stored in
	  the variable 'hwconfig'.
	  It configures generic attributes for 'serdesX', such as 'mode' (see below),
	  the clock type (internal or external),
	  clock frequency 'fmhz' (100 or 125, SGMII only modes), 'pcieX' mode
	  ('rc' or 'ep') and the 'xpcsX_Y' interfaces for any of the two lanes.
	  In the atributes presented above and below, 'X' (0 or 1) is the index
	  of the SerDes module and 'Y' (0 or 1) is the index of the XPCS interface.
	  SerDes 'mode' attribute can be 'pcie' (PCIe only mode), 'pcie&xpcsY' (PCIe
	  and SGMII combo mode), 'xpcs0&xpcs1' (SGMII only mode).
	  For the combo modes 'pcie&xpcsY', lane0 is PCIe and lane1
	  is connected to a GMAC or PFE MAC depending on 'Y' and 'fmhz' (which
	  match a certain SerDes configuration from the SerDes manual).
	  PCIe always works at 100MHz, therefore 'fmhz' is only for SGMII only mode.
	  Config 'xpcsX_Y' is used to specifically configure each of the two SGMII
	  PHYs, by setting the 'speed' (10M, 100M, 1G and 2G5).
	  S32R45 has two GMACs, GMAC0 running at 1Gbps and GMAC1 running at 2.5Gbps.

endif
```

## board/nxp/s32-cc/Kconfig
```kconfig
# SPDX-License-Identifier: GPL-2.0+
# Copyright 2022-2024 NXP

if NXP_S32CC

config NXP_S32CC_BOARD_COMMON
	bool
	default n
	imply ARCH_EARLY_INIT_R
	imply CMD_ADC
	imply CMD_CACHE
	imply CMD_CLK
	imply CMD_CPU
	imply CMD_DM
	imply CMD_E1000
	imply CMD_FUSE
	imply CMD_GPIO
	imply CMD_I2C
	imply CMD_MD5SUM
	imply CMD_MMC
	imply CMD_MMC_REG
	imply CMD_MP
	imply CMD_PCI
	imply CMD_SMC
	imply CMD_SPI
	imply CMD_TIME
	imply CMD_TIMER
	imply DM_REGULATOR
	imply MD5SUM_VERIFY
	imply USE_BOOTARGS

if NXP_S32CC_BOARD_COMMON

if QSPI_BOOT
config ENV_SECT_SIZE
	default 0x10000
endif
endif

config S32CC_SCMI_GPIO_FIXUP
	bool "Device tree fixup for SCMI GPIO protocol"
	default n

config S32CC_SCMI_NVMEM_FIXUP
	bool "Device tree fixup for SCMI NVMEM protocol"
	default n

config DTB_ADDR
	hex "Default OS device tree blob address"
	default 0x83000000

config RAMDISK_ADDR
	hex "Default ramdisk address to be used by the OS"
	default 0x90000000

endif
```
